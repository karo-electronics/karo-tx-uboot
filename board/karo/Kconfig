## board/karo/Kconfig
```kconfig
config BL31_BASE
	hex "Load address of BL31 image (imx-atf)"
	depends on ARM64
	default 0x00920000 if IMX8MM
	default 0x00960000 if IMX8MN
	default 0x00970000 if IMX8MP
	default 0x204c0000 if IMX91
	default 0x204e0000 if IMX93
	help
	  The load address for the BL31 image. This value is used to build the
	  FIT image header that places BL31 in memory where it will run.

config BL31_SIZE
	hex "memory space reserved for BL31 image"
	depends on ARM64
	default 0x20000 if IMX8M
	default 0x20000 if IMX91
	default 0x25000 if IMX93
	help
	  The memory size reserved for the BL31 image.

config UBOOT_IGNORE_ENV
       bool
       help
	 Ignore non-volatile environment settings and use default
	 environment only.

choice
	prompt "U-Boot image variant"
	default KARO_UBOOT_DEFAULT

config KARO_UBOOT_DEFAULT
	bool "Standard U-Boot image"

config KARO_UBOOT_MFG
	bool "U-Boot image for use with Freescale's MfGTool or UUU"
	select UBOOT_IGNORE_ENV

config KARO_UBOOT_NOENV
	bool "U-Boot using only built-in environment"
	select UBOOT_IGNORE_ENV

endchoice

config KARO_DTB_SELECT
	bool "Select the control DT at runtime from the stored 'baseboard'"
	depends on FIT
	select MULTI_DTB_FIT if !SPL
	select DTB_RESELECT if !SPL
	select SPL_LOAD_FIT if SPL
	help
	  One U-Boot image per module. The FIT appended to U-Boot (no SPL) or
	  loaded by SPL (SPL_LOAD_FIT) holds the control DT of the bare module
	  first and one DT per carrier named <module DT>-<baseboard>. The
	  'baseboard' variable of the stored environment picks one; without a
	  valid stored environment KARO_DEFAULT_BASEBOARD applies; an unknown
	  value keeps the bare module DT.

config SPL_KARO_DTB_SELECT
	bool
	default KARO_DTB_SELECT if SPL_LOAD_FIT
	help
	  Build the selection into SPL, where the boot media is already
	  initialised when the U-Boot FIT is parsed.

config KARO_DEFAULT_BASEBOARD
	string "Baseboard used when no stored environment is valid"
	depends on KARO_DTB_SELECT
	default ""
	help
	  Set by Yocto from KARO_BASEBOARD, the same value that lands in the
	  default environment text. Empty selects the bare module DT.

config KARO_DTB_SELECT_BUF_ADDR
	hex "Scratch DDR address for the environment block read"
	depends on KARO_DTB_SELECT
	default SYS_LOAD_ADDR
	help
	  ENV_SIZE bytes of DDR that nothing uses before relocation (and that
	  SPL does not load into). The early heap is too small for the block:
	  8 KiB on i.MX6, 64 KiB on i.MX9x, while the NAND environment of the
	  TX6 is 128 KiB.
```

## board/karo/common/Kconfig
```kconfig
if TARGET_KARO_STM32MP15 || TARGET_KARO_STM32MP13 || TARGET_KARO_STM32MP2 || TARGET_KARO_STM32MP23

if TARGET_KARO_STM32MP15 || TARGET_KARO_STM32MP13
source "board/karo/stm32mp1/Kconfig"
endif

if TARGET_KARO_STM32MP2 || TARGET_KARO_STM32MP23
source "board/karo/stm32mp2/Kconfig"
endif

config UBOOT_IGNORE_ENV
	bool
	help
	  Ignore non-volatile environment settings and use default
	  environment only but allow saving the environment to mass
	  storage.

config SYS_FDT_ADDR
	hex "FDT load address"
	default 0xc4000000 if STM32MP15X || STM32MP13X
	default 0x8c000000 if STM32MP25X || STM32MP23X
	help
	  The address the FDT file should be loaded to.

config KARO_STM32
	bool
	imply DM_RNG
	imply DM_USB
	imply DM_USB_GADGET
	imply RNG_STM32MP1

choice
	prompt "Ka-Ro STM32 module variant"

config KARO_TXMP_1570
	bool "Ka-Ro TXMP-1570 module"
	depends on TARGET_KARO_STM32MP15
	select KARO_STM32
	imply KARO_STM32_EMMC
	help
	  Enable support for the Ka-Ro electronics TXMP-1570 module featuring
	  an STM32MP157C SOC, 512MiB of SDRAM and 4GiB or 8GiB eMMC.

config KARO_TXMP_1571
	bool "Ka-Ro TXMP-1571 module"
	depends on TARGET_KARO_STM32MP15
	select KARO_STM32
	imply KARO_STM32_EMMC
	help
	  TXMP-1570 with corrected pinout compatible with the rest of the
	  TX module family

config KARO_QSMP_1510
	bool "Ka-Ro QSMP-1510 solder-in module"
	depends on TARGET_KARO_STM32MP15
	select KARO_STM32
	select KARO_STM32_NAND
	help
	  Enable support for the Ka-Ro electronics QSMP-1510 module featuring
	  an STM32MP151A SOC, 256MiB of SDRAM and 128MiB NAND flash on a
	  solder-in module.

config KARO_QSMP_1530
	bool "Ka-Ro QSMP-1530 solder-in module"
	depends on TARGET_KARO_STM32MP15
	select KARO_STM32
	imply KARO_STM32_EMMC
	help
	  Enable support for the Ka-Ro electronics QSMP-1530 module featuring
	  an STM32MP153A SOC, 256MiB of SDRAM and 4GiB eMMC on a solder-in
	  module.

config KARO_QSMP_1570
	bool "Ka-Ro QSMP-1570 solder-in module"
	depends on TARGET_KARO_STM32MP15
	select KARO_STM32
	imply KARO_STM32_EMMC
	help
	  Enable support for the Ka-Ro electronics QSMP-1570 module featuring
	  an STM32MP157C SOC, 512MiB of SDRAM and 4GiB eMMC on a solder-in
	  module.

config KARO_QSMP_1351
	bool "Ka-Ro QSMP-1351 solder-in module"
	depends on TARGET_KARO_STM32MP13
	select KARO_STM32
	imply KARO_STM32_EMMC
	help
	  Enable support for the Ka-Ro electronics QSMP-1351 module featuring
	  an STM32MP135C SOC, 256MiB of SDRAM and 4GiB eMMC on a solder-in
	  module.

config KARO_QSMP_2350
	bool "Ka-Ro QSMP-2350 module"
	depends on TARGET_KARO_STM32MP23
	select KARO_STM32
	imply KARO_STM32_EMMC
	help
	  Enable support for the Ka-Ro electronics QSMP-2350 module featuring
	  an STM32MP235C SOC, 1GiB of SDRAM and 4GiB eMMC.

config KARO_QSMP_2550
	bool "Ka-Ro QSMP-2550 module"
	depends on TARGET_KARO_STM32MP2
	select KARO_STM32
	imply KARO_STM32_EMMC
	help
	  Enable support for the Ka-Ro electronics QSMP-2550 module featuring
	  an STM32MP255F SOC, 1GiB of SDRAM and 4GiB eMMC.

config KARO_TXMP_2550
	bool "Ka-Ro TXMP-2550 module"
	depends on TARGET_KARO_STM32MP2
	select KARO_STM32
	imply KARO_STM32_EMMC
	help
	  Enable support for the Ka-Ro electronics TXMP-2550 module featuring
	  an STM32MP257F SOC, 1GiB of SDRAM and 4GiB or 8GiB eMMC.

config KARO_TXMP_2570
	bool "Ka-Ro TXMP-2570 module"
	depends on TARGET_KARO_STM32MP2
	select KARO_STM32
	imply KARO_STM32_EMMC
	help
	  Enable support for the Ka-Ro electronics TXMP-2570 module featuring
	  an STM32MP257F SOC, 1GiB of SDRAM and 4GiB or 8GiB eMMC.

endchoice

choice
	prompt "Ka-Ro TXMP/QSMP boot devices"
	default KARO_STM32_NAND if KARO_QSMP_1510
	default KARO_STM32_EMMC

config KARO_STM32_EMMC
	bool "eMMC device"

config KARO_STM32_NAND
	bool "SPI NAND device"
	depends on STM32_QSPI
	select DM_MTD

config KARO_STM32_SPI
	bool "SPI NOR device"
	depends on STM32_QSPI
	select DM_MTD

endchoice

choice
	prompt "U-Boot image variant"
	default KARO_UBOOT

config KARO_UBOOT
	bool "Standard U-Boot image"

config KARO_UBOOT_MFG
	bool "U-Boot image for use with stm32prog"

config KARO_UBOOT_NOENV
	bool "U-Boot using only built-in environment"
	select UBOOT_IGNORE_ENV

endchoice

endif
```

## board/karo/imx6/Kconfig
```kconfig
# SPDX-License-Identifier: GPL-2.0+

if TARGET_KARO_IMX6

config SYS_BOARD
	default "imx6"

config SYS_CONFIG_NAME
	default "imx6-karo"

config SYS_VENDOR
	default "karo"

config KARO_IMX6
	bool
	select CI_UDC_DISABLE_STREAMING if CI_UDC
	select DM
	select DM_ETH
	select DM_MMC
	imply BOARD_LATE_INIT
	imply DM_I2C_GPIO
	imply DM_PMIC
	imply FEC_MXC
	imply MXC_OCOTP
	imply OF_LIBFDT_OVERLAY
	imply OF_BOARD_SETUP
	imply PMIC_RN5T567

config KARO_IMX6_NAND
	bool
	imply CMD_MTDPARTS
	imply DM_MTD
	imply FDT_FIXUP_PARTITIONS
	imply MTD
	imply MTD_RAW_NAND
	imply NAND_MXS
	imply NAND_MXS_DT
	imply SYS_NAND_ONFI_DETECTION
	imply SYS_NAND_USE_FLASH_BBT

config KARO_IMX6_EMMC
	bool

choice
	prompt "Ka-Ro i.MX6 module variant"

config KARO_TXUL_8013
	bool "Ka-Ro TXUL-8013 module (i.MX6ULL, 512M DDR3L, 4G eMMC)"
	depends on MX6ULL
	select KARO_IMX6
	select KARO_IMX6_EMMC

config KARO_TXUL_5011
	bool "Ka-Ro TXUL-5011 module (i.MX6UL, 256M DDR3, 4G eMMC)"
	depends on MX6UL
	select KARO_IMX6
	select KARO_IMX6_EMMC

config KARO_TXUL_5010
	bool "Ka-Ro TXUL-5010 module (i.MX6UL, 256M DDR3, 128M NAND)"
	depends on MX6UL
	select KARO_IMX6
	select KARO_IMX6_NAND

config KARO_TX6S_8034
	bool "Ka-Ro TX6S-8034 module (i.MX6S, 256M DDR3, 128M NAND)"
	depends on MX6S
	select KARO_IMX6
	select KARO_IMX6_NAND

config KARO_TX6S_8134
	bool "Ka-Ro TX6S-8134 module (i.MX6S, 256M DDR3, 128M NAND, LVDS)"
	depends on MX6S
	select KARO_IMX6
	select KARO_IMX6_NAND

config KARO_TX6S_8035
	bool "Ka-Ro TX6S-8035 module (i.MX6S, 512M DDR3, 4G eMMC)"
	depends on MX6S
	select KARO_IMX6
	select KARO_IMX6_EMMC

config KARO_TX6S_8135
	bool "Ka-Ro TX6S-8135 module (i.MX6S, 512M DDR3, 4G eMMC, LVDS)"
	depends on MX6S
	select KARO_IMX6
	select KARO_IMX6_EMMC

config KARO_TX6U_8030
	bool "Ka-Ro TX6U-8030 module (i.MX6DL, 1G DDR3, 128M SLC NAND)"
	depends on MX6DL
	select KARO_IMX6
	select KARO_IMX6_NAND

config KARO_TX6U_8130
	bool "Ka-Ro TX6U-8130 module (i.MX6DL, 1G DDR3, 128M SLC NAND, LVDS)"
	depends on MX6DL
	select KARO_IMX6
	select KARO_IMX6_NAND

config KARO_TX6U_8033
	bool "Ka-Ro TX6U-8033 module (i.MX6DL, 1G DDR3, 4G eMMC)"
	depends on MX6DL
	select KARO_IMX6
	select KARO_IMX6_EMMC

config KARO_TX6U_8133
	bool "Ka-Ro TX6U-8133 module (i.MX6DL, 1G DDR3, 4G eMMC, LVDS)"
	depends on MX6DL
	select KARO_IMX6
	select KARO_IMX6_EMMC

config KARO_TX6Q_1030
	bool "Ka-Ro TX6Q-1030 module (i.MX6Q, 1G DDR3, 128M SLC NAND)"
	depends on MX6Q
	select KARO_IMX6
	select KARO_IMX6_NAND

config KARO_TX6Q_1130
	bool "Ka-Ro TX6Q-1130 module (i.MX6Q, 1G DDR3, 128M SLC NAND, LVDS)"
	depends on MX6Q
	select KARO_IMX6
	select KARO_IMX6_NAND

config KARO_TX6Q_1036
	bool "Ka-Ro TX6Q-1036 module (i.MX6Q, 1G DDR3, 8G eMMC)"
	depends on MX6Q
	select KARO_IMX6
	select KARO_IMX6_EMMC

config KARO_TX6Q_8037
	bool "Ka-Ro TX6Q-8037 module (i.MX6QP, 2G DDR3, 4G eMMC)"
	depends on MX6Q
	select KARO_IMX6
	select KARO_IMX6_EMMC

config KARO_TX6Q_8137
	bool "Ka-Ro TX6Q-8137 module (i.MX6QP, 2G DDR3, 4G eMMC, LVDS)"
	depends on MX6Q
	select KARO_IMX6
	select KARO_IMX6_EMMC

endchoice

config IMX_CONFIG
	default "board/karo/imx6/imximage-mx6ul.cfg" if MX6UL || MX6ULL
	default "board/karo/imx6/imximage-mx6qdl.cfg"

# i.MX6 RM Table 8-25: eMMC IVT at 1 KiB, SDP and NAND at 0
config KARO_IMX6_FLASH_PAD
	int
	default 1024 if KARO_IMX6_EMMC && !KARO_UBOOT_MFG
	default 0

endif
```

## board/karo/imx91/Kconfig
```kconfig
if TARGET_KARO_IMX91

config SYS_BOARD
	default "imx91"

config SYS_VENDOR
	default "karo"

config SYS_CONFIG_NAME
	default "tx91"

config KARO_IMX91
	bool
	select BINMAN
	select IMX9_LPDDR4X
	imply BOARD_LATE_INIT
	imply CHECK_REL_DYN
	imply DM_ETH
	imply DM_PMIC
	imply FEC_MXC
	imply IMX9_LPDDR4X
	imply MII
	imply MXC_UART
	imply PHYLIB
	imply POWER
	imply SPL_DM_PMIC
	imply SPL_DM_PMIC_PCA9450
	imply SPL_POWER
	imply SPL_SERIAL

choice
	prompt "Ka-Ro IMX91 module variant"
	default KARO_QS91_3110

config KARO_QS91_3110
	bool "Ka-Ro QS91-3110 module"
	select KARO_IMX91

config KARO_TX91_3110
	bool "Ka-Ro TX91-3110 module"
	select KARO_IMX91

endchoice

endif
```

## board/karo/stm32mp2/Kconfig
```kconfig
config SYS_BOARD
	default "stm32mp2"

config SYS_VENDOR
	default "karo"

config SYS_CONFIG_NAME
	default "txmp"

source "board/st/common/Kconfig"
```
