## configs/tx51-8xx0_defconfig
```kconfig
CONFIG_SYS_EXTRA_OPTIONS=SYS_CPU_CLK=800,NR_DRAM_BANKS=1
CONFIG_ARM=y
CONFIG_TARGET_TX51=y
```

## configs/tx53-x130_defconfig
```kconfig
CONFIG_SYS_EXTRA_OPTIONS="SYS_LVDS_IF"
CONFIG_ARM=y
CONFIG_TARGET_TX53=y
CONFIG_TARGET_TX53_X130=y
CONFIG_TX53_UBOOT=y
CONFIG_CMD_MII=y
CONFIG_CMD_DHCP=y
CONFIG_CMD_PING=y
CONFIG_BOOTP_SUBNETMASK=y
CONFIG_BOOTP_GATEWAY=y
CONFIG_BOOTP_DNS=y
CONFIG_MMC=y
CONFIG_FSL_ESDHC=y
CONFIG_FSL_USDHC=y
CONFIG_LCD=y
CONFIG_NET=y
CONFIG_NETDEVICES=y
CONFIG_FEC_MXC=y
CONFIG_IMX_WATCHDOG=y
CONFIG_CMD_I2C=y
CONFIG_DOS_PARTITION=y
CONFIG_ENV_IS_IN_NAND=y
CONFIG_SYS_PROMPT="TX53 U-Boot > "
```

## configs/tx6q-1020_noenv_defconfig
```kconfig
CONFIG_SYS_EXTRA_OPTIONS="MMC_BOOT_SIZE=4096,TX6_REV=0x2"
CONFIG_ARM=y
CONFIG_ARCH_MX6=y
CONFIG_TARGET_TX6=y
CONFIG_TARGET_TX6Q_1020=y
CONFIG_TX6_UBOOT_NOENV=y
CONFIG_BOOTP_DNS=y
CONFIG_BOOTP_GATEWAY=y
CONFIG_BOOTP_SUBNETMASK=y
CONFIG_CMD_BMP=y
CONFIG_CMD_BOOTCE=y
CONFIG_CMD_BOOTZ=y
CONFIG_CMD_CACHE=y
CONFIG_CMD_DHCP=y
CONFIG_CMD_FUSE=y
CONFIG_CMD_I2C=y
CONFIG_CMD_MEMTEST=y
CONFIG_CMD_MEMINFO=y
CONFIG_CMD_MII=y
CONFIG_CMD_MMC=y
CONFIG_CMD_PING=y
CONFIG_CMD_TIME=y
CONFIG_DOS_PARTITION=y
CONFIG_ENV_IS_IN_MMC=y
CONFIG_FEC_MXC=y
CONFIG_FEC_MXC_PHYADDR=0
CONFIG_IMX_WATCHDOG=y
CONFIG_LCD=y
CONFIG_NET=y
CONFIG_NETDEVICES=y
CONFIG_PHY_SMSC=y
CONFIG_SYS_PROMPT="TX6Q U-Boot > "
```

## configs/tx6s-8035_mfg_defconfig
```kconfig
CONFIG_SYS_EXTRA_OPTIONS="MMC_BOOT_SIZE=1024,SYS_SDRAM_BUS_WIDTH=32"
CONFIG_ARM=y
CONFIG_TARGET_TX6=y
CONFIG_TARGET_TX6S_8035=y
CONFIG_TX6_UBOOT_MFG=y
CONFIG_BOOTP_DNS=y
CONFIG_BOOTP_GATEWAY=y
CONFIG_BOOTP_SUBNETMASK=y
CONFIG_CMD_BMP=y
CONFIG_CMD_BOOTCE=y
CONFIG_CMD_BOOTZ=y
CONFIG_CMD_CACHE=y
CONFIG_CMD_DHCP=y
CONFIG_CMD_FUSE=y
CONFIG_CMD_I2C=y
CONFIG_CMD_MEMTEST=y
CONFIG_CMD_MEMINFO=y
CONFIG_CMD_MII=y
CONFIG_CMD_MMC=y
CONFIG_CMD_PING=y
CONFIG_CMD_TIME=y
CONFIG_DOS_PARTITION=y
CONFIG_ENV_IS_IN_MMC=y
CONFIG_FEC_MXC=y
CONFIG_FEC_MXC_PHYADDR=0
CONFIG_IMX_WATCHDOG=y
CONFIG_NET=y
CONFIG_NETDEVICES=y
CONFIG_PHY_SMSC=y
CONFIG_SYS_PROMPT="TX6S U-Boot > "
```

## configs/tx6u-8012_noenv_defconfig
```kconfig
CONFIG_SYS_EXTRA_OPTIONS="SYS_NAND_BLOCKS=2048"
CONFIG_ARM=y
CONFIG_ARCH_MX6=y
CONFIG_TARGET_TX6=y
CONFIG_TARGET_TX6U_8012=y
CONFIG_TX6_UBOOT_NOENV=y
CONFIG_BOOTP_DNS=y
CONFIG_BOOTP_GATEWAY=y
CONFIG_BOOTP_SUBNETMASK=y
CONFIG_CMD_BMP=y
CONFIG_CMD_BOOTCE=y
CONFIG_CMD_BOOTZ=y
CONFIG_CMD_CACHE=y
CONFIG_CMD_DHCP=y
CONFIG_CMD_FUSE=y
CONFIG_CMD_I2C=y
CONFIG_CMD_MEMTEST=y
CONFIG_CMD_MEMINFO=y
CONFIG_CMD_MII=y
CONFIG_CMD_MMC=y
CONFIG_CMD_MTDPARTS=y
CONFIG_CMD_NAND=y
CONFIG_CMD_NAND_TRIMFFS=y
CONFIG_CMD_PING=y
CONFIG_CMD_TIME=y
CONFIG_DOS_PARTITION=y
CONFIG_ENV_IS_IN_NAND=y
CONFIG_FEC_MXC=y
CONFIG_FEC_MXC_PHYADDR=0
CONFIG_IMX_WATCHDOG=y
CONFIG_LCD=y
CONFIG_MMC=y
CONFIG_NET=y
CONFIG_NETDEVICES=y
CONFIG_PHY_SMSC=y
CONFIG_SYS_PROMPT="TX6DL U-Boot > "
```

## configs/tx6u-81x0_mfg_defconfig
```kconfig
CONFIG_SYS_EXTRA_OPTIONS="SYS_LVDS_IF"
CONFIG_ARM=y
CONFIG_ARCH_MX6=y
CONFIG_TARGET_TX6=y
CONFIG_TARGET_TX6U_81X0=y
CONFIG_TX6_UBOOT_MFG=y
CONFIG_BOOTP_DNS=y
CONFIG_BOOTP_GATEWAY=y
CONFIG_BOOTP_SUBNETMASK=y
CONFIG_CMD_BMP=y
CONFIG_CMD_BOOTCE=y
CONFIG_CMD_BOOTZ=y
CONFIG_CMD_CACHE=y
CONFIG_CMD_DHCP=y
CONFIG_CMD_FUSE=y
CONFIG_CMD_I2C=y
CONFIG_CMD_MEMTEST=y
CONFIG_CMD_MEMINFO=y
CONFIG_CMD_MII=y
CONFIG_CMD_MMC=y
CONFIG_CMD_MTDPARTS=y
CONFIG_CMD_NAND=y
CONFIG_CMD_NAND_TRIMFFS=y
CONFIG_CMD_PING=y
CONFIG_CMD_TIME=y
CONFIG_DOS_PARTITION=y
CONFIG_ENV_IS_IN_NAND=y
CONFIG_FEC_MXC=y
CONFIG_FEC_MXC_PHYADDR=0
CONFIG_IMX_WATCHDOG=y
CONFIG_MMC=y
CONFIG_NET=y
CONFIG_NETDEVICES=y
CONFIG_PHY_SMSC=y
CONFIG_SYS_PROMPT="TX6DL U-Boot > "
```

## configs/tx6u-81x0_noenv_defconfig
```kconfig
CONFIG_ARM=y
CONFIG_MX6DL=y
CONFIG_TARGET_TX6=y
CONFIG_TARGET_TX6U_81X0=y
CONFIG_TX6_UBOOT_NOENV=y
CONFIG_CMD_MII=y
CONFIG_CMD_DHCP=y
CONFIG_CMD_PING=y
CONFIG_BOOTP_SUBNETMASK=y
CONFIG_BOOTP_GATEWAY=y
CONFIG_BOOTP_DNS=y
CONFIG_MMC=y
CONFIG_FSL_ESDHC=y
CONFIG_FSL_USDHC=y
CONFIG_LCD=y
CONFIG_NET=y
CONFIG_NETDEVICES=y
CONFIG_FEC_MXC=y
CONFIG_IMX_WATCHDOG=y
CONFIG_CMD_I2C=y
CONFIG_NAND=y
CONFIG_NAND_MXS=y
```

## configs/tx8p-ml81_defconfig
```kconfig
CONFIG_ARM=y
# CONFIG_ARM64_SUPPORT_AARCH32 is not set
CONFIG_ARCH_IMX8M=y
CONFIG_SYS_TEXT_BASE=0x40200000
CONFIG_SYS_MALLOC_F_LEN=0x1fff0
CONFIG_SPL_GPIO=y
CONFIG_SPL_LIBCOMMON_SUPPORT=y
CONFIG_SPL_LIBGENERIC_SUPPORT=y
CONFIG_NR_DRAM_BANKS=1
CONFIG_ENV_SIZE=0x1000
CONFIG_ENV_OFFSET=0x1ff000
CONFIG_IMX_CONFIG="board/$(VENDOR)/$(BOARD)/imximage-imx8mp.cfg"
CONFIG_DM_GPIO=y
CONFIG_DEFAULT_DEVICE_TREE="imx8mp-tx8p-ml81-mb7"
CONFIG_SPL_TEXT_BASE=0x920000
CONFIG_TARGET_TX8M=y
CONFIG_SPL_SERIAL=y
CONFIG_SPL_SYS_MALLOC_F_LEN=0xd000
CONFIG_SPL_SIZE_LIMIT=0x2c000
CONFIG_SPL_SIZE_LIMIT_PROVIDE_STACK=0x2000
CONFIG_SPL=y
CONFIG_ARMV8_SPL_EXCEPTION_VECTORS=y
CONFIG_SPL_IMX_ROMAPI_LOADADDR=0x48000000
CONFIG_KARO_TX8P_ML81=y
CONFIG_OF_BOARD_FIXUP=y
CONFIG_CHECK_REL_DYN=y
CONFIG_ENV_VARS_UBOOT_CONFIG=y
CONFIG_SYS_LOAD_ADDR=0x40400000
# CONFIG_ANDROID_BOOT_IMAGE is not set
CONFIG_FIT=y
CONFIG_TIMESTAMP=y
CONFIG_FIT_VERBOSE=y
CONFIG_SPL_LOAD_FIT=y
# CONFIG_USE_SPL_FIT_GENERATOR is not set
CONFIG_OF_BOARD_SETUP=y
CONFIG_OF_SYSTEM_SETUP=y
CONFIG_BOOTDELAY=1
CONFIG_BOOTARGS_SUBST=y
CONFIG_USE_PREBOOT=y
CONFIG_DEFAULT_FDT_FILE="imx8mp-tx8p-ml81.dtb"
CONFIG_LOGLEVEL=7
CONFIG_SYS_CONSOLE_INFO_QUIET=y
# CONFIG_SYS_STDIO_DEREGISTER is not set
CONFIG_ARCH_MISC_INIT=y
CONFIG_SPL_SYS_REPORT_STACK_F_USAGE=y
CONFIG_SPL_SHOW_ERRORS=y
CONFIG_SPL_BOARD_INIT=y
CONFIG_SPL_BOOTROM_SUPPORT=y
CONFIG_SPL_SYS_MALLOC_SIMPLE=y
CONFIG_SPL_SEPARATE_BSS=y
# CONFIG_SPL_BANNER_PRINT is not set
CONFIG_SYS_MMCSD_RAW_MODE_U_BOOT_USE_SECTOR=y
CONFIG_SYS_MMCSD_RAW_MODE_U_BOOT_SECTOR=0x300
CONFIG_SPL_CRYPTO=y
CONFIG_SPL_I2C=y
CONFIG_SPL_POWER=y
CONFIG_HUSH_PARSER=y
CONFIG_SYS_PROMPT="TX8P U-Boot > "
# CONFIG_BOOTM_NETBSD is not set
# CONFIG_BOOTM_PLAN9 is not set
# CONFIG_BOOTM_RTEMS is not set
# CONFIG_BOOTM_VXWORKS is not set
# CONFIG_CMD_ELF is not set
# CONFIG_CMD_XIMG is not set
CONFIG_CMD_ERASEENV=y
# CONFIG_CMD_CRC32 is not set
CONFIG_CMD_MEMTEST=y
# CONFIG_CMD_LZMADEC is not set
# CONFIG_CMD_UNLZ4 is not set
# CONFIG_CMD_UNZIP is not set
CONFIG_CMD_CLK=y
CONFIG_CMD_FUSE=y
CONFIG_CMD_GPIO=y
# CONFIG_CMD_GPT_RENAME is not set
CONFIG_CMD_I2C=y
CONFIG_CMD_MMC=y
CONFIG_CMD_PART=y
CONFIG_CMD_READ=y
CONFIG_CMD_USB=y
CONFIG_CMD_USB_MASS_STORAGE=y
CONFIG_CMD_WDT=y
CONFIG_CMD_DHCP=y
CONFIG_CMD_MII=y
CONFIG_CMD_PING=y
CONFIG_CMD_BMP=y
CONFIG_CMD_CACHE=y
CONFIG_CMD_CLS=y
CONFIG_CMD_TIME=y
CONFIG_CMD_EXT2=y
CONFIG_CMD_EXT4=y
CONFIG_CMD_EXT4_WRITE=y
CONFIG_CMD_FAT=y
CONFIG_CMD_FS_GENERIC=y
# CONFIG_DOS_PARTITION is not set
# CONFIG_SPL_EFI_PARTITION is not set
CONFIG_PARTITION_TYPE_GUID=y
CONFIG_OF_CONTROL=y
CONFIG_SPL_OF_CONTROL=y
CONFIG_OF_LIST="imx8mp-tx8p-ml81-mb7 imx8mp-tx8p-ml81"
CONFIG_ENV_OVERWRITE=y
CONFIG_ENV_IS_IN_MMC=y
CONFIG_SYS_RELOC_GD_ENV_ADDR=y
CONFIG_SYS_MMC_ENV_PART=1
CONFIG_USE_DEFAULT_ENV_FILE=y
CONFIG_DEFAULT_ENV_FILE="board/$(VENDOR)/$(BOARD)/tx8p-ml81-mb7.env"
CONFIG_ENV_VARS_UBOOT_RUNTIME_CONFIG=y
CONFIG_VERSION_VARIABLE=y
CONFIG_PROT_UDP=y
CONFIG_SPL_DM=y
CONFIG_SPL_DM_SEQ_ALIAS=y
CONFIG_REGMAP=y
CONFIG_SPL_REGMAP=y
CONFIG_SYSCON=y
CONFIG_SPL_CLK_IMX8MP=y
CONFIG_CLK_IMX8MP=y
CONFIG_USB_FUNCTION_FASTBOOT=y
CONFIG_FASTBOOT_BUF_ADDR=0x42800000
CONFIG_FASTBOOT_BUF_SIZE=0x40000000
CONFIG_FASTBOOT_FLASH=y
# CONFIG_FSL_FASTBOOT is not set
CONFIG_FASTBOOT_FLASH_MMC_DEV=0
CONFIG_FASTBOOT_MMC_BOOT_SUPPORT=y
CONFIG_FASTBOOT_MMC_USER_SUPPORT=y
CONFIG_FASTBOOT_CMD_OEM_PARTCONF=y
CONFIG_MXC_GPIO=y
CONFIG_DM_I2C=y
# CONFIG_INPUT is not set
CONFIG_SUPPORT_EMMC_BOOT=y
CONFIG_FSL_USDHC=y
CONFIG_DM_ETH=y
CONFIG_DM_ETH_PHY=y
CONFIG_DWC_ETH_QOS=y
CONFIG_DWC_ETH_QOS_IMX=y
CONFIG_MII=y
CONFIG_PINCTRL=y
# CONFIG_PINCONF_RECURSIVE is not set
CONFIG_SPL_PINCTRL=y
# CONFIG_SPL_PINCONF_RECURSIVE is not set
CONFIG_PINCTRL_IMX8M=y
CONFIG_DM_PMIC=y
CONFIG_SPL_DM_PMIC_PCA9450=y
CONFIG_DM_REGULATOR=y
CONFIG_SPL_DM_REGULATOR=y
CONFIG_DM_REGULATOR_FIXED=y
CONFIG_SPL_DM_REGULATOR_FIXED=y
CONFIG_DM_RESET=y
# CONFIG_REQUIRE_SERIAL_CONSOLE is not set
CONFIG_DM_SERIAL=y
CONFIG_SERIAL_RX_BUFFER=y
CONFIG_SERIAL_RX_BUFFER_SIZE=1024
CONFIG_MXC_UART=y
CONFIG_SYSRESET=y
CONFIG_SYSRESET_WATCHDOG=y
CONFIG_SYSRESET_WATCHDOG_AUTO=y
CONFIG_DM_THERMAL=y
CONFIG_IMX_TMU=y
CONFIG_USB=y
# CONFIG_SPL_DM_USB is not set
CONFIG_USB_XHCI_HCD=y
CONFIG_USB_XHCI_DWC3=y
CONFIG_USB_DWC3=y
CONFIG_USB_STORAGE=y
CONFIG_USB_GADGET=y
CONFIG_USB_GADGET_MANUFACTURER="FSL"
CONFIG_USB_GADGET_VENDOR_NUM=0x1fc9
CONFIG_USB_GADGET_PRODUCT_NUM=0x0152
CONFIG_USB_GADGET_VBUS_DRAW=60
CONFIG_DM_VIDEO=y
CONFIG_BACKLIGHT_GPIO=y
# CONFIG_CONSOLE_NORMAL is not set
CONFIG_VIDEO_IMX_SEC_DSI=y
CONFIG_VIDEO_IMX_LCDIFV3=y
# CONFIG_WATCHDOG is not set
# CONFIG_WATCHDOG_AUTOSTART is not set
CONFIG_IMX_WATCHDOG=y
CONFIG_WATCHDOG_RESET_DISABLE=y
# CONFIG_FAT_WRITE is not set
# CONFIG_SPL_USE_TINY_PRINTF is not set
# CONFIG_REGEX is not set
# CONFIG_SHA256 is not set
# CONFIG_SPL_SHA1 is not set
# CONFIG_GZIP is not set
CONFIG_HEXDUMP=y
CONFIG_SPL_HEXDUMP=y
CONFIG_OF_LIBFDT_OVERLAY=y
# CONFIG_EFI_LOADER is not set
```

## configs/tx8p-ml81_noenv_defconfig
```kconfig
CONFIG_ARM=y
# CONFIG_ARM64_SUPPORT_AARCH32 is not set
CONFIG_ARCH_IMX8M=y
CONFIG_SYS_TEXT_BASE=0x40200000
CONFIG_SPL_GPIO_SUPPORT=y
CONFIG_SPL_LIBCOMMON_SUPPORT=y
CONFIG_SPL_LIBGENERIC_SUPPORT=y
CONFIG_SYS_MALLOC_F_LEN=0xc000
CONFIG_SYS_I2C_MXC_I2C1=y
CONFIG_SYS_I2C_MXC_I2C2=y
CONFIG_SYS_I2C_MXC_I2C3=y
CONFIG_ENV_SIZE=0x1000
CONFIG_ENV_OFFSET=0x1ff000
CONFIG_DM_GPIO=y
CONFIG_TARGET_TX8M=y
CONFIG_KARO_TX8P_ML81=y
CONFIG_TX8M_UBOOT_NOENV=y
CONFIG_SPL_SERIAL_SUPPORT=y
CONFIG_SPL_SYS_MALLOC_F_LEN=0x1400
CONFIG_NR_DRAM_BANKS=1
CONFIG_SPL=y
CONFIG_CSF_SIZE=0x2000
CONFIG_SPL_IMX_ROMAPI_LOADADDR=0x48000000
CONFIG_SPL_TEXT_BASE=0x920000
CONFIG_CHECK_REL_DYN=y
CONFIG_ENV_VARS_UBOOT_CONFIG=y
CONFIG_FIT=y
# CONFIG_FIT_ENABLE_SHA256_SUPPORT is not set
CONFIG_SPL_LOAD_FIT=y
CONFIG_SPL_FIT_GENERATOR="arch/arm/mach-imx/mkimage_fit_atf.sh"
CONFIG_OF_BOARD_SETUP=y
CONFIG_OF_SYSTEM_SETUP=y
CONFIG_SYS_EXTRA_OPTIONS="IMX_CONFIG=arch/arm/mach-imx/imx8m/imximage-8mp-lpddr4.cfg"
CONFIG_BOOTDELAY=-1
CONFIG_LOGLEVEL=7
CONFIG_CONSOLE_MUX=y
CONFIG_SYS_CONSOLE_INFO_QUIET=y
CONFIG_SYS_STDIO_DEREGISTER=y
CONFIG_DEFAULT_FDT_FILE="imx8mp-tx8p-ml81-mipi-mb.dtb"
CONFIG_VERSION_VARIABLE=y
CONFIG_ARCH_MISC_INIT=y
CONFIG_SPL_BOARD_INIT=y
CONFIG_SPL_BOOTROM_SUPPORT=y
CONFIG_SPL_SYS_MALLOC_SIMPLE=y
CONFIG_SPL_SEPARATE_BSS=y
CONFIG_SYS_MMCSD_RAW_MODE_U_BOOT_USE_SECTOR=y
CONFIG_SYS_MMCSD_RAW_MODE_U_BOOT_SECTOR=0x300
CONFIG_SPL_I2C_SUPPORT=y
CONFIG_SPL_POWER_SUPPORT=y
CONFIG_SYS_PROMPT="TX8P U-Boot > "
# CONFIG_BOOTM_NETBSD is not set
# CONFIG_BOOTM_PLAN9 is not set
# CONFIG_BOOTM_RTEMS is not set
# CONFIG_BOOTM_VXWORKS is not set
# CONFIG_CMD_ELF is not set
# CONFIG_CMD_XIMG is not set
CONFIG_CMD_ERASEENV=y
# CONFIG_CMD_CRC32 is not set
CONFIG_CMD_MEMTEST=y
CONFIG_CMD_CLK=y
CONFIG_CMD_FUSE=y
CONFIG_CMD_GPIO=y
CONFIG_CMD_GPT=y
CONFIG_CMD_GPT_RENAME=y
CONFIG_CMD_I2C=y
CONFIG_CMD_MMC=y
CONFIG_CMD_PART=y
CONFIG_CMD_READ=y
CONFIG_CMD_USB=y
CONFIG_CMD_USB_MASS_STORAGE=y
CONFIG_CMD_DHCP=y
# CONFIG_BOOTP_BOOTPATH is not set
# CONFIG_BOOTP_HOSTNAME is not set
CONFIG_CMD_MII=y
CONFIG_CMD_PING=y
CONFIG_CMD_CACHE=y
CONFIG_CMD_TIME=y
CONFIG_CMD_REGULATOR=y
CONFIG_CMD_EXT2=y
CONFIG_CMD_EXT4=y
CONFIG_CMD_EXT4_WRITE=y
CONFIG_CMD_FAT=y
CONFIG_CMD_FS_GENERIC=y
# CONFIG_SPL_DOS_PARTITION is not set
CONFIG_EFI_PARTITION_ENTRIES_OFF=2048
# CONFIG_SPL_EFI_PARTITION is not set
CONFIG_PARTITION_TYPE_GUID=y
CONFIG_OF_CONTROL=y
CONFIG_OF_BOARD_FIXUP=y
CONFIG_SPL_OF_CONTROL=y
CONFIG_DEFAULT_DEVICE_TREE="imx8mp-tx8p-ml81-mipi-mb"
CONFIG_OF_SPL_REMOVE_PROPS="pinctrl-0 pinctrl-names clocks clock-names interrupt-parent interrupts"
CONFIG_ENV_IS_IN_MMC=y
CONFIG_SYS_RELOC_GD_ENV_ADDR=y
CONFIG_USE_DEFAULT_ENV_FILE=y
CONFIG_DEFAULT_ENV_FILE="board/${VENDOR}/${BOARD}/tx8p-ml81_env.txt"
CONFIG_ENV_VARS_UBOOT_RUNTIME_CONFIG=y
CONFIG_SPL_DM=y
CONFIG_SPL_DM_SEQ_ALIAS=y
CONFIG_REGMAP=y
CONFIG_SPL_REGMAP=y
CONFIG_SYSCON=y
CONFIG_CLK_IMX8MP=y
CONFIG_MXC_GPIO=y
CONFIG_SYS_I2C_MXC=y
CONFIG_SYS_MXC_I2C1_SPEED=400000
CONFIG_SYS_MXC_I2C2_SPEED=400000
CONFIG_SYS_MXC_I2C3_SPEED=400000
# CONFIG_INPUT is not set
CONFIG_DM_MMC=y
CONFIG_SUPPORT_EMMC_BOOT=y
CONFIG_FSL_USDHC=y
CONFIG_PHY_SMSC=y
CONFIG_DM_ETH=y
CONFIG_DM_MDIO=y
CONFIG_DM_ETH_PHY=y
CONFIG_DWC_ETH_QOS=y
# CONFIG_FEC_MXC is not set
CONFIG_PINCTRL=y
# CONFIG_PINCONF_RECURSIVE is not set
CONFIG_SPL_PINCTRL=y
CONFIG_PINCTRL_IMX8M=y
CONFIG_DM_REGULATOR=y
CONFIG_DM_REGULATOR_FIXED=y
CONFIG_DM_RESET=y
# CONFIG_REQUIRE_SERIAL_CONSOLE is not set
CONFIG_DM_SERIAL=y
CONFIG_SERIAL_RX_BUFFER=y
CONFIG_SERIAL_RX_BUFFER_SIZE=1024
CONFIG_DM_THERMAL=y
CONFIG_NXP_TMU=y
CONFIG_USB=y
CONFIG_DM_USB=y
# CONFIG_SPL_DM_USB is not set
CONFIG_USB_XHCI_HCD=y
CONFIG_USB_XHCI_DWC3=y
CONFIG_USB_DWC3=y
CONFIG_USB_STORAGE=y
CONFIG_USB_GADGET=y
CONFIG_USB_GADGET_MANUFACTURER="FSL"
CONFIG_USB_GADGET_VENDOR_NUM=0x0525
CONFIG_USB_GADGET_PRODUCT_NUM=0xa4a5
CONFIG_USB_GADGET_VBUS_DRAW=60
CONFIG_USB_GADGET_DOWNLOAD=y
CONFIG_FAT_WRITE=y
# CONFIG_SPL_USE_TINY_PRINTF is not set
CONFIG_PANIC_HANG=y
# CONFIG_REGEX is not set
CONFIG_OF_LIBFDT_OVERLAY=y
# CONFIG_EFI_LOADER is not set
```

## configs/txa5-5011_defconfig
```kconfig
CONFIG_SYS_EXTRA_OPTIONS="SAMA5D4,SYS_USE_MMC"
CONFIG_ARM=y
CONFIG_ARCH_AT91=y
CONFIG_TARGET_TXA5=y
CONFIG_TARGET_TXA5_5011=y
CONFIG_TXA5_UBOOT=y
CONFIG_CMD_MII=y
CONFIG_CMD_DHCP=y
CONFIG_CMD_PING=y
CONFIG_BOOTP_SUBNETMASK=y
CONFIG_BOOTP_GATEWAY=y
CONFIG_BOOTP_DNS=y
CONFIG_MMC=y
CONFIG_LCD=y
CONFIG_NET=y
CONFIG_NETDEVICES=y
#CONFIG_CMD_I2C=y
CONFIG_DOS_PARTITION=y
CONFIG_ENV_IS_IN_MMC=y
CONFIG_SYS_PROMPT="TXA5 U-Boot > "
```

## configs/txsd-410e_defconfig
```kconfig
CONFIG_ARM=y
CONFIG_ARCH_SNAPDRAGON=y
CONFIG_TARGET_TXSD_410E=y
CONFIG_IDENT_STRING="\nKa-Ro electronics TXSD-410E"
CONFIG_DEFAULT_DEVICE_TREE="txsd-410e"
CONFIG_SD_BOOT=y
CONFIG_BOOTDELAY=3
CONFIG_SYS_NO_FLASH=y
CONFIG_VERSION_VARIABLE=y
CONFIG_SYS_PROMPT="TXSD U-Boot > "
CONFIG_BLK=y
CONFIG_CLK=y
CONFIG_CMD_CPU=y # overridden by CONFIG_MP
CONFIG_CMD_MEMTEST=y
CONFIG_CMD_MMC=y
CONFIG_CMD_I2C=y
CONFIG_CMD_USB=y
CONFIG_CMD_GPIO=y
CONFIG_CMD_SMD=y
CONFIG_CMD_SPMI=y
CONFIG_CMD_DHCP=y
CONFIG_CMD_MII=y
CONFIG_CMD_PING=y
CONFIG_CMD_CACHE=y
CONFIG_CMD_TIMER=y
CONFIG_CMD_PMIC=y
CONFIG_CMD_EXT2=y
CONFIG_CMD_EXT4=y
CONFIG_CMD_EXT4_WRITE=y
CONFIG_CMD_FAT=y
CONFIG_CMD_FS_GENERIC=y
# CONFIG_CMD_CRC32 is not set
# CONFIG_CMD_FLASH is not set
# CONFIG_CMD_FPGA is not set
# CONFIG_CMD_IMI is not set
# CONFIG_CMD_IMLS is not set
# CONFIG_CMD_XIMG is not set
CONFIG_CPU=y
CONFIG_DEBUG_TIMER_WRAP=y
CONFIG_DEBUG_TIMER_WRAP_SECONDS=60
# CONFIG_EFI_LOADER is not set
CONFIG_MSM_GPIO=y
CONFIG_PM8916_GPIO=y
CONFIG_DM_ETH=y
CONFIG_DM_I2C=y
CONFIG_DM_I2C_GPIO=y
CONFIG_DM_MMC=y
CONFIG_DM_MMC_OPS=y
CONFIG_DM_PMIC=y
CONFIG_DM_RTC=y
CONFIG_LED=y
CONFIG_LED_GPIO=y
CONFIG_MSM_SDHCI=y
CONFIG_OF_BOARD_SETUP=y
CONFIG_OF_CONTROL=y
CONFIG_OF_SEPARATE=y
CONFIG_PINCTRL=y
CONFIG_PINCONF=y
# CONFIG_REQUIRE_SERIAL_CONSOLE is not set
CONFIG_PMIC_PM8916=y
CONFIG_MSM_SERIAL=y
CONFIG_QCOM_SMD=y
CONFIG_QCOM_SMD_RPM=y
CONFIG_SPMI_MSM=y
CONFIG_SYSRESET=y
# CONFIG_SYS_MALLOC_CLEAR_ON_INIT is not set
CONFIG_USB=y
CONFIG_DM_USB=y
CONFIG_USB_EHCI_HCD=y
CONFIG_USB_EHCI_MSM=y
CONFIG_USB_ULPI_VIEWPORT=y
CONFIG_USB_ULPI=y
CONFIG_USB_STORAGE=y
CONFIG_CONSOLE_ROTATION=y
CONFIG_VIDEO_BRIDGE=y
# CONFIG_REGEX is not set
```

## disk/Kconfig
```kconfig
config PARTITIONS
       bool

config DOS_PARTITION
       bool "Support DOS partitions"
       select PARTITIONS

config MAC_PARTITION
       bool "Support MAC partitions"
       select PARTITIONS
```
