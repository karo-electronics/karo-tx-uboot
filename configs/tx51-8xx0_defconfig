## drivers/dma/Kconfig
```kconfig
config APBH_DMA
	bool "Freescale MXS and i.MX6 APBH DMA support"
	depends on ARCH_MXS || ARCH_MX6

config APBH_DMA_BURST
	bool "Enable DMA burst mode"
	default y
	depends on APBH_DMA

config APBH_DMA_BURST8
	bool "Use 8-beat DMA bursts"
	default y
	depends on APBH_DMA_BURST
```

## drivers/i2c/Kconfig
```kconfig
config DM_I2C
	bool "Enable Driver Model for I2C drivers"
	depends on DM
	help
	  If you want to use driver model for I2C drivers, say Y.
	  To use legacy I2C drivers, say N.

config SYS_I2C_UNIPHIER
	bool "UniPhier I2C driver"
	depends on ARCH_UNIPHIER && DM_I2C
	default y
	help
	  Support for Panasonic UniPhier I2C controller driver.  This I2C
	  controller is used on PH1-LD4, PH1-sLD8 or older UniPhier SoCs.

config SYS_I2C_UNIPHIER_F
	bool "UniPhier FIFO-builtin I2C driver"
	depends on ARCH_UNIPHIER && DM_I2C
	default y
	help
	  Support for Panasonic UniPhier FIFO-builtin I2C controller driver.
	  This I2C controller is used on PH1-Pro4 or newer UniPhier SoCs.
menuconfig SYS_I2C
	bool "I2C device support"

if SYS_I2C

config HARD_I2C
	bool

config SYS_I2C_MXC
	bool "Freescale i.MX I2C controller"
	select HARD_I2C
	select I2C_QUIRK_REG if FSL_LSCH3 || LS102XA

endif
```

## drivers/misc/Kconfig
```kconfig
config DM_CROS_EC
	bool "Enable Driver Model for Chrome OS EC"
	depends on DM
	help
	  Enable driver model for the Chrome OS EC interface. This
	  allows the cros_ec SPI driver to operate with CONFIG_DM_SPI
	  but otherwise makes few changes. Since cros_ec also supports
	  I2C and LPC (which don't support driver model yet), a full
	  conversion is not yet possible.

config MXC_OCOTP
	bool "Freescale OCOTP support"
	depends on SOC_MX5 || SOC_MX6

config MXS_OCOTP
	bool "Freescale OCOTP support"
	depends on SOC_MXS
```

## drivers/mmc/Kconfig
```kconfig
menuconfig MMC
	bool "MMC Host controller Support"

if MMC

config GENERIC_MMC
	bool

config DM_MMC
	bool "Enable MMC controllers using Driver Model"
	depends on DM
	help
	  This enables the MultiMediaCard (MMC) uclass which suports MMC and
	  Secure Digital I/O (SDIO) cards. Both removable (SD, micro-SD, etc.)
	  and non-removable (e.g. eMMC chip) devices are supported. These
	  appear as block devices in U-Boot and can support filesystems such
	  as EXT4 and FAT.

config SH_SDHI
	bool "SuperH/Renesas ARM SoCs on-chip SDHI host controller support"
	depends on RMOBILE
	help
	  Support for the on-chip SDHI host controller on SuperH/Renesas ARM SoCs platform

config FSL_ESDHC
	bool "Freescale ESDHC controller"
	select GENERIC_MMC

config FSL_USDHC
	bool "Support USDHC"
	depends on FSL_ESDHC && ARCH_MX6

config MXS_MMC
	bool "i.MXS MMC/SDHC controller"
	depends on ARCH_MXS || ARCH_MX6
	select GENERIC_MMC
	select BOUNCE_BUFFER

config OMAP_HSMMC
	bool "OMAP HSMMC controller"
	select GENERIC_MMC

config SUPPORT_EMMC_BOOT
	bool "Support boot from eMMC"

endif
```

## drivers/mtd/Kconfig
```kconfig
menuconfig NOR_FLASH
	bool "NOR flash support"

if NOR_FLASH

config CONFIG_FLASH_CFI_DRIVER
	bool "CFI flash driver"

endif

config SYS_NO_FLASH
	bool
	default y
	depends on !NOR_FLASH

config MTD_PARTITIONS
	bool "Support MTD partition tables"
	depends on MTD_DEVICE
	default y

source "drivers/mtd/nand/Kconfig"
```

## drivers/mtd/nand/spi/Kconfig
```kconfig
menuconfig MTD_SPI_NAND
	bool "SPI NAND device Support"
	depends on DM_MTD && DM_SPI
	select MTD_NAND_CORE
	select SPI_MEM
	help
	  This is the framework for the SPI NAND device drivers.

if MTD_SPI_NAND

config MTD_SPI_NAND_GIGADEVICE
	bool "Gigadevice SPI NAND support"
	help
	  Add support for Gigadevice GD5F1GQ4UExxG SPI NAND devices.

config MTD_SPI_NAND_MACRONIX
	bool "Macronix SPI NAND support"
	help
	  Add support for Macronix MX35LFxGE4AB SPI NAND devices.

config MTD_SPI_NAND_MICRON
	bool "Micron SPI NAND support"
	help
	  Add support for Micron MT29F2G01 SPI NAND devices.

config MTD_SPI_NAND_NETSOL
	bool "Netsol SPI NAND support"
	help
	  Add support for Netsol STF1GE4U00M SPI NAND devices.

config MTD_SPI_NAND_TOSHIBA
	bool "Toshiba SPI NAND support"
	help
	  Add support for Toshiba SPI NAND devices.

config MTD_SPI_NAND_WINBOND
	bool "Winbond SPI NAND support"
	help
	  Add support for Winbond W25[MN] SPI NAND devices.

endif
```

## drivers/net/Kconfig
```kconfig
config DM_ETH
	bool "Enable Driver Model for Ethernet drivers"
	depends on DM
	help
	  Enable driver model for Ethernet.

	  The eth_*() interface will be implemented by the UC_ETH class
	  This is currently implemented in net/eth.c
	  Look in include/net.h for details.

menuconfig NETDEVICES
	bool "Network device support"
	depends on NET
	help
	  You must select Y to enable any network device support
	  Generally if you have any networking support this is a given

	  If unsure, say Y

if NETDEVICES

config ETH_SANDBOX
	depends on DM_ETH && SANDBOX
	default y
	bool "Sandbox: Mocked Ethernet driver"
	help
	  This driver simply responds with fake ARP replies and ping
	  replies that are used to verify network stack functionality

	  This driver is particularly useful in the test/dm/eth.c tests

config MII
	bool

config FEC_MXC
	bool "Freescale FEC ethernet controller"
	select MII

config GET_FEC_MAC_ADDR_FROM_IIM
	bool "Read FEC MAC address from fuses"
	depends on FEC_MXC

if FEC_MXC

config FEC_MXC_PHYADDR
	int "FEC Ethernet PHY address"
       	default 0
	depends on !FEC_MXC_MULTI

endif

source "drivers/net/phy/Kconfig"

endif # NETDEVICES
```

## drivers/net/phy/Kconfig
```kconfig
config PHYLIB
	bool "Generic PHY support"

config PHY_SMSC
	bool "SMSC PHY support"
```

## drivers/thermal/Kconfig
```kconfig
config DM_THERMAL
	bool "Driver support for thermal devices"
	help
	  Enable support for temporary-sensing devices. Some SoCs have on-chip
	  temperature sensors to permit warnings, speed throttling or even
	  automatic power-off when the temperature gets too high or low. Other
	  devices may be discrete but connected on a suitable bus.

config IMX6_THERMAL
	bool "Driver for i.MX6 thermal sensor"
	depends on ARCH_MX6
	help
	  Enable support for the thermal sensor inside the i.MX6 SoC.
```

## drivers/watchdog/Kconfig
```kconfig
config HW_WATCHDOG
	bool "Generic SoC specific watchdog support"
	depends on !ARCH_MX6

config IMX_WATCHDOG
	bool "Freescale i.MX watchdog support"
	depends on SOC_MX31 || SOC_MX35 || ARCH_MX5 || ARCH_MX6 || SOC_VF610 || SOC_LS102XA
```
