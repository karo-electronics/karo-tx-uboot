// SPDX-License-Identifier: GPL-2.0+
/*
 * Ka-Ro TX6Q-1130 module on MB7 baseboard
 */

#include "imx6q-tx6q-1030-mb7.dts"

/ {
	model = "Ka-Ro TX6Q-1130 Module on MB7 baseboard";
	compatible = "karo,imx6q-tx6q-1130-mb7", "karo,imx6q-tx6q", "fsl,imx6q";
};
