// SPDX-License-Identifier: (GPL-2.0 or MIT)
/*
 * Copyright 2023 Lothar Waßmann <LW@KARO-electronics.de>
 */

#include "imx91-karo-u-boot.dtsi"

&lpuart1 {
	bootph-all;
};

&pinctrl_lpuart1 {
	bootph-all;
};

&pinctrl_lpuart1_rtscts {
	bootph-all;
};
