// SPDX-License-Identifier: GPL-2.0+
/*
 * Ka-Ro TX6U-8130 module on MB7 baseboard
 */

#include "imx6dl-tx6u-8030-mb7.dts"

/ {
	model = "Ka-Ro TX6U-8130 Module on MB7 baseboard";
	compatible = "karo,imx6dl-tx6u-8130-mb7", "karo,imx6dl-tx6u", "fsl,imx6dl";
};
