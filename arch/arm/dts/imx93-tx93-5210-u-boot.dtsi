// SPDX-License-Identifier: (GPL-2.0 or MIT)
/*
 * Copyright 2023 Lothar Waßmann <LW@KARO-electronics.de>
 */

#include "imx93-karo-u-boot.dtsi"

&pinctrl_uart1_rtscts {
	bootph-all;
};

&pinctrl_uart3_rtscts {
	bootph-all;
};
