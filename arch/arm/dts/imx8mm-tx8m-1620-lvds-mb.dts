// SPDX-License-Identifier: (GPL-2.0 OR MIT)
/*
 * Copyright (C) 2020 Lothar Waßmann <LW@KARO-electronics.de>
 *
 */

#include "imx8mm-tx8m-1620.dts"

/ {
	model = "Ka-Ro electronics TX8M-1620 (NXP i.MX8MM) module on TX-MIPI-LVDS baseboard";
};

&usdhc2 {
	pinctrl-0 = <&pinctrl_usdhc2>;
	/delete-property/ cd-gpios;
	no-mmc;
};
