// SPDX-License-Identifier: GPL-2.0+
/*
 * Ka-Ro TX6Q-1036 module on MB7 baseboard
 */

#include "imx6q-tx6q-1036.dts"

/ {
	model = "Ka-Ro TX6Q-1036 Module on MB7 baseboard";
	compatible = "karo,imx6q-tx6q-1036-mb7", "karo,imx6q-tx6q", "fsl,imx6q";

	aliases {
		usbotg = &usbotg;
	};
};

#include "imx6qdl-tx6-mb7.dtsi"
