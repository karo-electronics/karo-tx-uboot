// SPDX-License-Identifier: (GPL-2.0 OR MIT)
/*
 * Copyright (C) 2021 Lothar Waßmann <LW@KARO-electronics.de>
 *
 */

#include "imx8mp-karo-u-boot.dtsi"

&uart2 {
	bootph-all;
};

&uart4 {
	bootph-all;
};
