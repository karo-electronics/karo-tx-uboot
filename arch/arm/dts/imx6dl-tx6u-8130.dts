// SPDX-License-Identifier: GPL-2.0+
/*
 * Copyright (C) 2026 Ka-Ro Electronics GmbH
 * Ka-Ro TX6U-8130 module: the TX6U-8030 with LVDS
 */

#include "imx6dl-tx6u-8030.dts"

/ {
	model = "Ka-Ro electronics TX6U-8130 Module";
	compatible = "karo,imx6dl-tx6u-8130", "karo,imx6dl-tx6u", "fsl,imx6dl";
};
