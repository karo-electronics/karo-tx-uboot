// SPDX-License-Identifier: (GPL-2.0 OR MIT)
/*
 * Copyright 2020 Lothar Waßmann <LW@KARO-electronics.de>
 *
 */

#include "imx8mp-tx8p-ml81.dts"
#include "imx8mp-tx8p-lvds-mb.dtsi"

/ {
	model = "Ka-Ro TX8P-ML81 module on TX-MIPI-LVDS baseboard";
};

&usdhc2 {
	pinctrl-names = "default";
	pinctrl-0 = <&pinctrl_usdhc2>;
	no-mmc;
};
