// SPDX-License-Identifier: (GPL-2.0 OR MIT)
/*
 * Copyright (C) 2021 Lothar Waßmann <LW@KARO-electronics.de>
 *
 */
#include "imx8m-tx8m-u-boot.dtsi"

&pinctrl_usdhc3 {
	u-boot,dm-spl;
};

&pinctrl_usdhc3_100mhz {
	u-boot,dm-spl;
};

&pinctrl_usdhc3_200mhz {
	u-boot,dm-spl;
};

&usdhc3 {
	mmc-hs400-1_8v;
	mmc-hs400-enhanced-strobe;
	u-boot,dm-spl;
};
