// SPDX-License-Identifier: GPL-2.0+
/*
 * Copyright (C) 2026 Ka-Ro Electronics GmbH
 * U-Boot additions of the TX6 eMMC modules, as imx93-karo-u-boot.dtsi
 */

&uart1 {
	bootph-all;
};

&pinctrl_uart1 {
	bootph-all;
};

/* eMMC read by the pre-relocation DT selection */
&usdhc4 {
	bootph-all;
};

&pinctrl_usdhc4 {
	bootph-all;
};
