// SPDX-License-Identifier: GPL-2.0+
/*
 * Copyright (C) 2026 Ka-Ro Electronics GmbH
 * Ka-Ro TX6Q-8137 module: the TX6Q-8037 with LVDS
 */

#include "imx6qp-tx6q-8037.dts"

/ {
	model = "Ka-Ro electronics TX6Q-8137 Module";
	compatible = "karo,imx6qp-tx6q-8137", "karo,imx6qp-tx6q", "fsl,imx6qp";
};
