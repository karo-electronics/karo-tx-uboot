// SPDX-License-Identifier: GPL-2.0+
/*
 * Ka-Ro TX6S-8135 module on MB7 baseboard
 */

#include "imx6dl-tx6s-8035-mb7.dts"

/ {
	model = "Ka-Ro TX6S-8135 Module on MB7 baseboard";
	compatible = "karo,imx6dl-tx6s-8135-mb7", "karo,imx6dl-tx6s", "fsl,imx6dl";
};
