// SPDX-License-Identifier: (GPL-2.0 OR MIT)
/*
 * Copyright (C) 2023 Lothar Waßmann <LW@KARO-electronics.de>
 *
 */

#include "imx8mm-tx8m-1622.dts"

/ {
	model = "Ka-Ro electronics TX8M-1622 (NXP i.MX8MM) module on TX-MIPI-LVDS baseboard";
};
