#include "imx8mm-tx8m-1610.dts"

/ {
	model = "Ka-Ro electronics TX8M-1610 (NXP i.MX8MM) module on TX-MIPI-LVDS baseboard";
};

&usdhc2 {
	pinctrl-0 = <&pinctrl_usdhc2>;
	/delete-property/ cd-gpios;
	no-mmc;
	broken-cd;
};
