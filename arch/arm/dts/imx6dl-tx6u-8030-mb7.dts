// SPDX-License-Identifier: GPL-2.0+
/*
 * Ka-Ro TX6U-8030 module on MB7 baseboard
 */

#include "imx6dl-tx6u-8030.dts"

/ {
	model = "Ka-Ro TX6U-8030 Module on MB7 baseboard";
	compatible = "karo,imx6dl-tx6u-8030-mb7", "karo,imx6dl-tx6u", "fsl,imx6dl";

	aliases {
		usbotg = &usbotg;
	};
};

#include "imx6qdl-tx6-mb7.dtsi"
