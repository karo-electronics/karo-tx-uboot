// SPDX-License-Identifier: (GPL-2.0 OR MIT)
/*
 * Copyright (C) 2020 Lothar Waßmann <LW@KARO-electronics.de>
 *
 */

#include "imx8mm-tx8m-16xx-u-boot.dtsi"

&pinctrl_uart2_rtscts {
	u-boot,dm-spl;
};
