// SPDX-License-Identifier: (GPL-2.0 or MIT)
/*
 * Copyright 2023 Lothar Waßmann <LW@KARO-electronics.de>
 */

#include "imx93-tx93-5210.dts"

/ {
	model = "Ka-Ro electronics GmbH TX93-5210 (NXP i.MX93) module on MB7 baseboard";
};

&usdhc2 {
	pinctrl-0 = <&pinctrl_usdhc2 &pinctrl_usdhc2_cd>;
	cd-gpios = <&gpio3 0 GPIO_ACTIVE_LOW>;
};
