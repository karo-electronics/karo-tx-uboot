// SPDX-License-Identifier: (GPL-2.0 OR MIT)
/*
 * Copyright (C) 2020 Lothar Waßmann <LW@KARO-electronics.de>
 *
 */

/dts-v1/;

#include "imx8mm-tx8m-16xx.dtsi"

/ {
	model = "Ka-Ro electronics TX8M-1610 (NXP i.MX8MM) module";
};

&usbotg2 {
	dr_mode = "host";
	status = "okay";
};
