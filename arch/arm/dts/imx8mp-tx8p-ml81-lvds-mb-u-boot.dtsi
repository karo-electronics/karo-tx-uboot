// SPDX-License-Identifier: (GPL-2.0 OR MIT)
/*
 * Copyright (C) 2021 Lothar Waßmann <LW@KARO-electronics.de>
 *
 */

#include "imx8mp-tx8p-ml81-u-boot.dtsi"

&usdhc2 {
	pinctrl-0 = <&pinctrl_usdhc2>;
	/delete-property/ cd-gpios;
	fsl,cd-data3;
};
