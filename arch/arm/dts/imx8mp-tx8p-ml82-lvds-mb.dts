// SPDX-License-Identifier: (GPL-2.0 OR MIT)
/*
 * Copyright 2022 Lothar Waßmann <LW@KARO-electronics.de>
 *
 */

#include "imx8mp-tx8p-ml81-lvds-mb.dts"

/ {
	model = "Ka-Ro TX8P-ML82 module on TX-MIPI-LVDS baseboard";
};
