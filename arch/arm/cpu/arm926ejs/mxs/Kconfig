## arch/arm/cpu/armv7/mx5/Kconfig
```kconfig
if ARCH_MX5

config SOC_MX51
	bool

config SOC_MX53
	bool

choice
	prompt "MX5 board select"
	optional

config TARGET_USBARMORY
	bool "Support USB armory"
	select CPU_V7

endchoice

config SYS_SOC
	default "mx5"

source "board/inversepath/usbarmory/Kconfig"

endif
```

## arch/arm/cpu/armv7/mx6/Kconfig
```kconfig
if ARCH_MX6

config SOC_MX6
	bool
	default y

config SOC_MX6D
	bool

config SOC_MX6DL
	bool

config SOC_MX6Q
	bool

config SOC_MX6QDL
	bool

config SOC_MX6S
	bool

config SOC_MX6SL
	bool

config SOC_MX6SX
	bool

config SOC_MX6UL
	select SYS_L2CACHE_OFF
	bool

choice
	prompt "MX6 board select"
	optional

config TARGET_CM_FX6
	bool "Support CM-FX6"
	select SUPPORT_SPL
	select DM
	select DM_SERIAL
	select DM_GPIO

config TARGET_SECOMX6
	bool "Support secomx6 boards"

config TARGET_TQMA6
	bool "TQ Systems TQMa6 board"

endchoice

config SYS_SOC
	default "mx6"

source "board/seco/Kconfig"
source "board/tqc/tqma6/Kconfig"

endif
```

## arch/arm/mach-snapdragon/Kconfig
```kconfig
if ARCH_SNAPDRAGON

config SYS_SOC
	default "snapdragon"

choice
	prompt "Snapdragon board select"

config TARGET_DRAGONBOARD410C
	bool "96Boards Dragonboard 410C"
	help
	  Support for 96Boards Dragonboard 410C. This board complies with
	  96Board Open Platform Specifications. Features:
	  - Qualcomm Snapdragon 410C SoC - APQ8016 (4xCortex A53, Adreno 306)
	  - 1GiB RAM
	  - 8GiB eMMC, uSD slot
	  - WiFi, Bluetooth and GPS module
	  - 2x Host, 1x Device USB port
	  - HDMI
	  - 20-pin low speed and 40-pin high speed expanders, 4 LED, 3 buttons

config TARGET_TXSD_410E
	bool "Ka-Ro electronics TXSD-410E"
	help
	  Support for Ka-Ro electronics TXSD-410E module. This board
	  is compatible with the Qualcomm Snapdragon 410C board and
	  has a form factor like the TX-Series modules produced by
	  Ka-Ro electronics GmbH.

endchoice

source "board/qualcomm/dragonboard410c/Kconfig"
source "board/karo/txsd/Kconfig"

endif
```

## board/karo/imx93/Kconfig
```kconfig
if TARGET_TX93

config SYS_BOARD
	default "imx93"

config SYS_CONFIG_NAME
	default "tx93"

config SYS_VENDOR
	default "karo"

config KARO_IMX93
	bool
	select BINMAN
	imply BOARD_LATE_INIT
	imply DM_ETH
	imply DM_PMIC
	imply FEC_MXC
	imply IMX9_LPDDR4X
	imply MII
	imply MXC_UART
	imply PHYLIB
	imply POWER
	imply SPL_DM_PMIC
	imply SPL_DM_PMIC_PCA9450
	imply SPL_POWER
	imply SPL_SERIAL

choice
	prompt "Ka-Ro IMX93 module variant"
	default KARO_TX93_5210

config KARO_TX93_5210
	bool "Ka-Ro TX93-5210 module"
	select KARO_IMX93

config KARO_QS93_5210
	bool "Ka-Ro QS93-5210 module"
	select KARO_IMX93

endchoice

endif
```

## board/karo/stm32mp1/Kconfig
```kconfig
source "board/karo/common/Kconfig"

if TARGET_KARO_STM32MP1

config SYS_BOARD
	default "stm32mp1"

config SYS_VENDOR
	default "karo"

config SYS_CONFIG_NAME
	default "txmp"

config KARO_STM32
	bool
	imply DM_RNG
	imply DM_USB
	imply DM_USB_GADGET
	imply RNG_STM32MP1

source "board/st/common/Kconfig"

choice
	prompt "Ka-Ro STM32 module variant"

config KARO_TXMP_1570
	bool "Ka-Ro TXMP-1570 module"
	depends on STM32MP15X
	select KARO_STM32
	imply KARO_STM32_EMMC
	help
	  Enable support for the Ka-Ro electronics TXMP-1570 module featuring
	  an STM32MP157C SOC, 512MiB of SDRAM and 4GiB or 8GiB eMMC.

config KARO_TXMP_1571
	bool "Ka-Ro TXMP-1571 module"
	depends on STM32MP15X
	select KARO_STM32
	imply KARO_STM32_EMMC
	help
	  TXMP-1570 with corrected pinout compatible with the rest of the
	  TX module family

config KARO_QSMP_1510
	bool "Ka-Ro QSMP-1510 solder-in module"
	depends on STM32MP15X
	select KARO_STM32
	select KARO_STM32_NAND
	help
	  Enable support for the Ka-Ro electronics QSMP-1510 module featuring
	  an STM32MP151A SOC, 256MiB of SDRAM and 128MiB NAND flash on a
	  solder-in module.

config KARO_QSMP_1530
	bool "Ka-Ro QSMP-1530 solder-in module"
	depends on STM32MP15X
	select KARO_STM32
	imply KARO_STM32_EMMC
	help
	  Enable support for the Ka-Ro electronics QSMP-1530 module featuring
	  an STM32MP153A SOC, 256MiB of SDRAM and 4GiB eMMC on a solder-in
	  module.

config KARO_QSMP_1570
	bool "Ka-Ro QSMP-1570 solder-in module"
	depends on STM32MP15X
	select KARO_STM32
	imply KARO_STM32_EMMC
	help
	  Enable support for the Ka-Ro electronics QSMP-1570 module featuring
	  an STM32MP157C SOC, 512MiB of SDRAM and 4GiB eMMC on a solder-in
	  module.

config KARO_QSMP_1351
	bool "Ka-Ro QSMP-1351 solder-in module"
	depends on STM32MP13X
	select KARO_STM32
	imply KARO_STM32_EMMC
	help
	  Enable support for the Ka-Ro electronics QSMP-1351 module featuring
	  an STM32MP135C SOC, 256MiB of SDRAM and 4GiB eMMC on a solder-in
	  module.

endchoice

choice
	prompt "Ka-Ro TXMP/QSMP boot device"
	default KARO_STM32_NAND if KARO_QSMP_1510
	default KARO_STM32_EMMC

config KARO_STM32_EMMC
	bool "eMMC device"

config KARO_STM32_NAND
	bool "SPI NAND device"
	depends on STM32_QSPI
	select DM_MTD

config KARO_STM32_SPI
	bool "SPI NOR device"
	depends on STM32_QSPI
	select DM_MTD

endchoice

choice
        prompt "U-Boot image variant"
        default KARO_UBOOT

config KARO_UBOOT
        bool "Standard U-Boot image"

config KARO_UBOOT_MFG
        bool "U-Boot image for use with stm32prog"

config KARO_UBOOT_NOENV
        bool "U-Boot using only built-in environment"
        select UBOOT_IGNORE_ENV

endchoice

endif
```

## board/karo/tx28/Kconfig
```kconfig
if TARGET_TX28

config SYS_BOARD
	default "tx28"

config SYS_VENDOR
	default "karo"

config SYS_SOC
	default "mxs"

config SYS_CONFIG_NAME
	default "tx28"

config TX28
	bool
	default y
	select SOC_MX28
	select SPL
	select APBH_DMA
	select APBH_DMA_BURST
	select APBH_DMA_BURST8
	select CC_OPTIMIZE_LIBS_FOR_SPEED
	select CMD_NAND_TRIMFFS if CMD_NAND
	select FDT_FIXUP_PARTITIONS
	select GET_FEC_MAC_ADDR_FROM_IIM if FEC_MXC
	select LIB_RAND
	select MTD_DEVICE
	select MTD_PARTITIONS
	select MXS_MMC if MMC
	select NAND
	select NAND_MXS
	select OF_BOARD_SETUP
	select OF_LIBFDT
	select SYS_NAND_USE_FLASH_BBT

config TARGET_TX28_40X2
	bool
	select TX28

config TARGET_TX28_40X3
	bool
	select TX28

config TARGET_TX28_41X0
	bool
	select TX28

choice
	prompt "U-Boot image variant"
	default TX28_UBOOT

config TX28_UBOOT
	bool "Standard U-Boot image"

config TX28_UBOOT_NOENV
	bool "U-Boot using only built-in environment"
	select UBOOT_IGNORE_ENV

endchoice

endif
```

## board/karo/tx48/Kconfig
```kconfig
if TARGET_TX48

config SYS_BOARD
	default "tx48"

config SYS_VENDOR
	default "karo"

config SYS_SOC
	default "am33xx"

config SYS_CONFIG_NAME
	default "tx48"

config TX48
	bool
	default y
	select PHYLIB
	select SPL

endif
```

## board/karo/tx51/Kconfig
```kconfig
if TARGET_TX51

config SYS_BOARD
	default "tx51"

config SYS_VENDOR
	default "karo"

config SYS_SOC
	default "mx5"

config SYS_CONFIG_NAME
	default "tx51"

config TX51
	bool
	default y
	select CC_OPTIMIZE_LIBS_FOR_SPEED
	select CMD_BMP if LCD
	select CMD_BOOTCE
	select CMD_BOOTZ
	select CMD_CACHE
	select CMD_MEMINFO
	select CMD_MEMTEST
	select CMD_MMC
	select CMD_NAND
	select CMD_NAND_TRIMFFS
	select CMD_ROMUPDATE
	select CMD_TIME
	select DM
	select DM_GPIO
	select FDT_FIXUP_PARTITIONS if OF_LIBFDT
	select GET_FEC_MAC_ADDR_FROM_IIM
	select IMX_WATCHDOG
	select LIB_RAND
	select MMC
	select MTD_PARTITIONS
	select MTD_DEVICE
	select NAND
	select NAND_MXC
	select OF_LIBFDT
	select OF_BOARD_SETUP
	select PHYLIB
	select PHY_SMSC
	select SOC_MX51
	select SYS_NAND_USE_FLASH_BBT if NAND_MXC

choice
	prompt "TX51 module variant"

config TARGET_TX51_8XX0
	bool "TX51-8010 and TX51-8110"

config TARGET_TX51_8XX1_2
	bool "TX51-8021, TX51-8021, TX51-8022 and TX51-8122"

endchoice

config NR_DRAM_BANKS
	int
	default 1

choice
	prompt "U-Boot image variant"

config TX51_UBOOT
	bool "Standard U-Boot image"

config TX51_UBOOT_NOENV
	bool "U-Boot using only built-in environment"
	select UBOOT_IGNORE_ENV

endchoice

endif
```

## board/karo/tx53/Kconfig
```kconfig
if TARGET_TX53

config SYS_BOARD
	default "tx53"

config SYS_VENDOR
	default "karo"

config SYS_SOC
	default "mx5"

config SYS_CONFIG_NAME
	default "tx53"

config TX53
	bool
	default y
	select CC_OPTIMIZE_LIBS_FOR_SPEED
	select CMD_BMP if LCD
	select CMD_BOOTCE
	select CMD_BOOTZ
	select CMD_CACHE
	select CMD_I2C if I2C
	select CMD_MEMINFO
	select CMD_MEMTEST
	select CMD_MMC
	select CMD_NAND
	select CMD_NAND_TRIMFFS
	select CMD_ROMUPDATE
	select CMD_TIME
	select DM
	select DM_GPIO
	select FDT_FIXUP_PARTITIONS if OF_LIBFDT
	select GET_FEC_MAC_ADDR_FROM_IIM
	select IMX_WATCHDOG
	select LIB_RAND
	select MMC
	select MTD_PARTITIONS
	select MTD_DEVICE
	select NAND
	select NAND_MXC
	select OF_LIBFDT
	select OF_BOARD_SETUP
	select PHYLIB
	select PHY_SMSC
	select SOC_MX53
	select SYS_I2C
	select SYS_I2C_MXC
	select SYS_NAND_USE_FLASH_BBT if NAND_MXC

#
# variables selected depending on module variant
#

config SYS_LVDS_IF
	bool

choice
	prompt "TX53 module variant"

config TARGET_TX53_X030
	bool "TX53-8030 and TX53-1030"

config TARGET_TX53_X130
	bool "TX53-8130 and TX53-1330"
	select SYS_LVDS_IF

config TARGET_TX53_X131
	bool "TX53-8131 and TX53-1331"
	select SYS_LVDS_IF

config TARGET_TX53_1232
	bool "TX53-1232"

endchoice

config NR_DRAM_BANKS
	int
	default 2 if TARGET_TX53_1232 || TARGET_TX53_X131
	default 1

choice
	prompt "U-Boot image variant"

config TX53_UBOOT
	bool "Standard U-Boot image"

config TX53_UBOOT_NOENV
	bool "U-Boot using only built-in environment"
	select UBOOT_IGNORE_ENV

endchoice

endif
```

## board/karo/tx6/Kconfig
```kconfig
if TARGET_TX6

config SYS_BOARD
	default "tx6"

config SYS_VENDOR
	default "karo"

config SYS_SOC
	default "mx6"

config SYS_CONFIG_NAME
	default "tx6"

config TX6
	bool
	default y
	select APBH_DMA
	select APBH_DMA_BURST
	select APBH_DMA_BURST8
	select CC_OPTIMIZE_LIBS_FOR_SPEED
	select DM
	select DM_GPIO
	select DM_THERMAL
	select FSL_ESDHC if MMC
	select FSL_USDHC if MMC
	select IMX6_THERMAL
	select LIB_RAND
	select PHYLIB
	select GET_FEC_MAC_ADDR_FROM_IIM if FEC_MXC
	select MXC_OCOTP if CMD_FUSE
	select OF_BOARD_SETUP
	select OF_LIBFDT

config TX6_NAND
	bool
	default ! TX6_EMMC
	select CMD_NAND_TRIMFFS if CMD_NAND
	select CMD_ROMUPDATE
	select FDT_FIXUP_PARTITIONS
	select MTD_DEVICE
	select MTD_PARTITIONS
	select NAND
	select NAND_MXS
	select NAND_MXS_NO_BBM_SWAP
	select SYS_NAND_USE_FLASH_BBT

config TX6_EMMC
	bool
	select CMD_MMC
	select MMC
	select SUPPORT_EMMC_BOOT

config TX6UL
	bool
	select SOC_MX6UL
	select SYS_SDRAM_BUS_WIDTH_16

config TX6QP
	bool

#
# variables selected depending on module variant
#
config SYS_LVDS_IF
	bool

config SYS_SDRAM_BUS_WIDTH_16
	bool

config SYS_SDRAM_BUS_WIDTH_32
	bool

config SYS_SDRAM_CHIP_SIZE
	int "SDRAM chip size in MiB"

choice
	prompt "TX6 module variant"

config TARGET_TX6Q_NAND
	bool "TX6Q modules with NAND flash (TX6Q-1030/TX6Q-1130)"
	select SOC_MX6Q
	select SYS_I2C
	select SYS_I2C_MXC

config TARGET_TX6Q_EMMC
	bool "TX6Q modules with eMMC (TX6Q-1020/TX6Q-1036)"
	select SOC_MX6Q
	select SYS_I2C
	select SYS_I2C_MXC
	select TX6_EMMC

config TARGET_TX6S_NAND
	bool "TX6S modules with NAND flash (TX6S-8034/TX6S-8134)"
	select SOC_MX6S
	select SYS_I2C
	select SYS_I2C_MXC

config TARGET_TX6S_EMMC
	bool "TX6S modules with eMMC (TX6S-8035/TX6S-8135)"
	select SOC_MX6S
	select SYS_I2C
	select SYS_I2C_MXC
	select TX6_EMMC

config TARGET_TX6U_NAND
	bool "TX6U (i.MX6DL) modules with NAND flash (TX6U-8030/TX6U-8032)"
	select SOC_MX6DL
	select SYS_I2C
	select SYS_I2C_MXC

config TARGET_TX6U_EMMC
	bool "TX6U (i.MX6DL) modules with eMMC (TX6U-8033/TX6U-8133)"
	select SOC_MX6DL
	select SYS_I2C
	select SYS_I2C_MXC
	select TX6_EMMC

config TARGET_TX6UL_NAND
	bool "TXUL (i.MX6UL) modules with NAND flash (TXUL-5010)"
	select TX6UL

config TARGET_TX6UL_EMMC
	bool "TXUL (i.MX6UL) modules with eMMC (TXUL-5011)"
	select TX6UL
	select TX6_EMMC

config TARGET_TX6QP_EMMC
	bool "TX6Q modules with i.MX6Q+ and eMMC (TX6QP-8037)"
	select SOC_MX6Q
	select SYS_I2C
	select SYS_I2C_MXC
	select TX6_EMMC
	select TX6QP

endchoice

choice
	prompt "U-Boot image variant"
	default TX6_UBOOT

config TX6_UBOOT
	bool "Standard U-Boot image"

config TX6_UBOOT_MFG
	bool "U-Boot image for use with Freescale's MfGTool"

config TX6_UBOOT_NOENV
	bool "U-Boot using only built-in environment"
	select UBOOT_IGNORE_ENV

endchoice

endif
```

## board/karo/tx8m/Kconfig
```kconfig
if TARGET_TX8M

config SYS_BOARD
	default "tx8m"

config SYS_CONFIG_NAME
	default "tx8m"

config SYS_VENDOR
	default "karo"

config KARO_IMX8M
	bool
	select BINMAN
	select BOARD_LATE_INIT
	imply BINMAN_FDT
	imply SPL_BINMAN_SYMBOLS

config KARO_TX8M
	bool
	select KARO_IMX8M
	imply IMX8M_DDR3L

config KARO_QS8M
	bool
	select KARO_IMX8M
	imply IMX8M_DDR3L

config KARO_QSXM
	bool
	select KARO_IMX8M
	imply IMX8M_LPDDR4

config KARO_TX8P
	bool
	select KARO_IMX8M
	select CLK_COMPOSITE_CCF
	select SPL_CLK_COMPOSITE_CCF
	imply IMX8M_LPDDR4

choice
	prompt "Ka-Ro TX8M/QS8M module variant"
	default KARO_TX8MM_1610

config KARO_TX8MM_1610
	bool "Ka-Ro TX8M-1610 module"
	select IMX8MM
	select KARO_TX8M

config KARO_TX8MM_1620
	bool "Ka-Ro TX8M-1620 module"
	select IMX8MM
	select KARO_TX8M

config KARO_TX8MM_1622
	bool "Ka-Ro TX8M-1622 module"
	select IMX8MM
	select KARO_TX8M

config KARO_QS8M_MQ00
	bool "Ka-Ro QS8M-MQ00 (TX8M-1610 compatible solder-in module)"
	select IMX8MM
	select KARO_QS8M

config KARO_TX8MN
	bool "Ka-Ro TX8M-ND00 module"
	select IMX8MN
	select KARO_TX8M

config KARO_QS8M_ND00
	bool "Ka-Ro QS8M-ND00 (TX8M-ND00 compatible solder-in module)"
	select IMX8MN
	select KARO_QS8M

config KARO_QSXM_MM60
	bool "Ka-Ro QSXM-MM60 solder-in module with LPDDR4"
	select IMX8MM
	select KARO_QSXM

config KARO_QSXP_ML81
	bool "Ka-Ro QSXP-ML81 solder-in module with LPDDR4"
	select IMX8MP
	select CLK_COMPOSITE_CCF
	select SPL_CLK_COMPOSITE_CCF
	select KARO_QSXM

config KARO_TX8P_ML81
	bool "Ka-Ro TX8P-ML81 module with 2GiB LPDDR4"
	select IMX8MP
	select KARO_TX8P

config KARO_TX8P_ML82
	bool "Ka-Ro TX8P-ML82 module with 4GiB LPDDR4"
	select IMX8MP
	select KARO_TX8P

endchoice

endif
```

## board/karo/txa5/Kconfig
```kconfig
if TARGET_TXA5

config SYS_BOARD
	default "txa5"

config SYS_VENDOR
	default "karo"

config SYS_SOC
	default "at91"

config SYS_CONFIG_NAME
	default "txa5"

config TXA5
	bool
	default y
	select CC_OPTIMIZE_LIBS_FOR_SPEED
	select CMD_BMP if LCD
	select CMD_BOOTCE
	select CMD_BOOTZ
	select CMD_CACHE
	select CMD_I2C if I2C
	select CMD_MEMINFO
	select CMD_MEMTEST
	select CMD_MMC
	select CMD_TIME
	select DM
	select DM_GPIO
#	select GET_FEC_MAC_ADDR_FROM_IIM
#	select IMX_WATCHDOG
	select MMC
	select OF_LIBFDT
	select OF_BOARD_SETUP
	select PHYLIB
#	select PHY_SMSC
#	select SYS_I2C
#	select SYS_I2C_MXC

config TXA5_NAND
	bool
	select TXA5
	select CMD_NAND
	select CMD_NAND_TRIMFFS
	select CMD_ROMUPDATE
	select ENV_IS_IN_NAND
	select FDT_FIXUP_PARTITIONS if OF_LIBFDT
	select MTD_PARTITIONS
	select MTD_DEVICE
	select NAND
	select NAND_ATMEL
	select SYS_NAND_USE_FLASH_BBT

config TXA5_EMMC
	bool
	select TXA5
	select SUPPORT_EMMC_BOOT
	select ENV_IS_IN_MMC

choice
	prompt "TXA5 module variant"

config TARGET_TXA5_5010
	bool "TXA5-5010 (NAND)"
	select TXA5_NAND

config TARGET_TXA5_5011
	bool "TXA5-5011 (eMMC)"
	select TXA5_EMMC

endchoice

#
# variables selected depending on module variant
#

config NR_DRAM_BANKS
	int
	default 1

choice
	prompt "U-Boot image variant"

config TXA5_UBOOT
	bool "Standard U-Boot image"

config TXA5_UBOOT_NOENV
	bool "U-Boot using only built-in environment"
	select UBOOT_IGNORE_ENV

endchoice

endif
```
