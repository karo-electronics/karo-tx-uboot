## board/karo/txmp/Kconfig
```kconfig
source "board/karo/common/Kconfig"

if TARGET_KARO_TXMP

config SYS_BOARD
	default "txmp"

config SYS_VENDOR
	default "karo"

config SYS_CONFIG_NAME
	default "txmp"

config KARO_STM32
	bool

choice
	prompt "Ka-Ro STM32 module variant"

config KARO_TXMP_1530
	bool "Ka-Ro TXMP-1530 module"
	select KARO_STM32
	imply TXMP_EMMC
	help
	  Enable support for the Ka-Ro electronics TXMP-1530 module featuring
	  an STM32MP153A SOC, 256MiB of SDRAM and 4GiB or 8GiB eMMC.

config KARO_TXMP_1570
	bool "Ka-Ro TXMP-1570 module"
	select KARO_STM32
	imply TXMP_EMMC
	help
	  Enable support for the Ka-Ro electronics TXMP-1570 module featuring
	  an STM32MP157C SOC, 512MiB of SDRAM and 4GiB or 8GiB eMMC.

config KARO_QSMP_1510
	bool "Ka-Ro QSMP-1510 solder-in module"
	select KARO_STM32
	select TXMP_NAND
	help
	  Enable support for the Ka-Ro electronics QSMP-1510 module featuring
	  an STM32MP151A SOC, 256MiB of SDRAM and 128MiB NAND flash on a
	  solder-in module.

config KARO_QSMP_1530
	bool "Ka-Ro QSMP-1530 solder-in module"
	select KARO_STM32
	imply TXMP_EMMC
	help
	  Enable support for the Ka-Ro electronics QSMP-1530 module featuring
	  an STM32MP153A SOC, 256MiB of SDRAM and 4GiB eMMC on a solder-in
	  module.

config KARO_QSMP_1570
	bool "Ka-Ro QSMP-1570 solder-in module"
	select KARO_STM32
	imply TXMP_EMMC
	help
	  Enable support for the Ka-Ro electronics QSMP-1570 module featuring
	  an STM32MP157C SOC, 512MiB of SDRAM and 4GiB eMMC on a solder-in
	  module.

endchoice

choice
	prompt "Ka-Ro TXMP/QSMP boot device"
	default TXMP_EMMC

config TXMP_EMMC
	bool "eMMC device"

config TXMP_NAND
	bool "SPI NAND device"
	depends on STM32_QSPI
	select DM_MTD

config TXMP_SPI
	bool "SPI NOR device"
	depends on STM32_QSPI
	select DM_MTD

endchoice

choice
        prompt "U-Boot image variant"
        default KARO_UBOOT

config KARO_UBOOT
        bool "Standard U-Boot image"

config KARO_UBOOT_MFG
        bool "U-Boot image for use with stm32prog"

config KARO_UBOOT_NOENV
        bool "U-Boot using only built-in environment"
        select UBOOT_IGNORE_ENV

endchoice

endif
```

## board/karo/txrz/Kconfig
```kconfig
source "board/karo/common/Kconfig"

if TARGET_TXRZ

config SYS_SOC
	default "rmobile"

config SYS_BOARD
	default "txrz"

config SYS_VENDOR
	default "karo"

config SYS_CONFIG_NAME
	default "txrz"

choice
	prompt "Ka-Ro STM32 module variant"

config KARO_TXRZ_G2L0
	bool "Ka-Ro TXRZ-G2L0 module"
	select BOARD_LATE_INIT
	help
	  Enable support for the Ka-Ro electronics TXRZ-G2L0 module featuring
	  an RZ/G2L SOC, 1024MiB of SDRAM and 4GiB eMMC.

config KARO_TXRZ_G2L1
	bool "Ka-Ro TXRZ-G2L1 module"
	select BOARD_LATE_INIT
	help
	  Enable support for the Ka-Ro electronics TXRZ-G2L1 module featuring
	  an RZ/G2L SOC, 512MiB of SDRAM and 4GiB eMMC.

config KARO_QSRZ_G2L0
	bool "Ka-Ro QSRZ-G2L0 module"
	select BOARD_LATE_INIT
	help
	  Enable support for the Ka-Ro electronics QSRZ-G2L0 module featuring
	  an RZ/G2L SOC, 1024MiB of SDRAM and 4GiB eMMC.

config KARO_QSRZ_G2L1
	bool "Ka-Ro QSRZ-G2L1 module"
	select BOARD_LATE_INIT
	help
	  Enable support for the Ka-Ro electronics QSRZ-G2L1 module featuring
	  an RZ/G2L SOC, 512MiB of SDRAM and 4GiB eMMC.

endchoice

endif
```

## board/karo/txsd/Kconfig
```kconfig
if TARGET_TXSD_410E

config SYS_BOARD
	default "txsd"

config SYS_VENDOR
	default "karo"

config SYS_SOC
	default "apq8016"

config SYS_CONFIG_NAME
	default "txsd"

endif
```

## common/Kconfig
```kconfig
menu "Command line interface"
	depends on !SPL_BUILD

config HUSH_PARSER
	bool "Use hush shell"
	select SYS_HUSH_PARSER
	help
	  This option enables the "hush" shell (from Busybox) as command line
	  interpreter, thus enabling powerful command line syntax like
	  if...then...else...fi conditionals or `&&' and '||'
	  constructs ("shell scripts").

	  If disabled, you get the old, much simpler behaviour with a somewhat
	  smaller memory footprint.

config SYS_HUSH_PARSER
	bool
	help
	  Backward compatibility.

comment "Commands"

menu "Info commands"

config CMD_BDI
	bool "bdinfo"
	default y
	help
	  Print board info

config CMD_CONSOLE
	bool "coninfo"
	default y
	help
	  Print console devices and information.

config CMD_LICENSE
	bool "license"
	help
	  Print GPL license text

endmenu

menu "Boot commands"

config CMD_BOOTD
	bool "bootd"
	default y
	help
	  Run the command stored in the environment "bootcmd", i.e.
	  "bootd" does the same thing as "run bootcmd".

config CMD_BOOTM
	bool "bootm"
	default y
	help
	  Boot an application image from the memory.

config CMD_BOOTZ
	bool "bootz"
	default y
	help
	  Boot a Linux kernel zImage.

config CMD_BOOTCE
	bool "bootce"
	help
	  Boot a WindowsCE image.

config CMD_GO
	bool "go"
	default y
	help
	  Start an application at a given address.

config CMD_RUN
	bool "run"
	default y
	help
	  Run the command in the given environment variable.

config CMD_IMI
	bool "iminfo"
	default y
	help
	  Print header information for application image.

config CMD_IMLS
	bool "imls"
	default !SYS_NO_FLASH
	help
	  List all images found in flash

config CMD_XIMG
	bool "imxtract"
	default y
	help
	  Extract a part of a multi-image.

endmenu

menu "DTB support"

config OF_LIBFDT
	bool "Enable FDT commands"

config OF_BOARD_SETUP
	bool "Support DT modifications by board code"
	depends on OF_LIBFDT

endmenu

menu "Environment commands"

config CMD_EXPORTENV
	bool "env export"
	default y
	help
	  Export environments.

config CMD_IMPORTENV
	bool "env import"
	default y
	help
	  Import environments.

config CMD_EDITENV
	bool "editenv"
	default y
	help
	  Edit environment variable.

config CMD_SAVEENV
	bool "saveenv"
	default y
	help
	  Run the command in the given environment variable.

endmenu

menu "Memory commands"

config CMD_MEMORY
	bool "md, mm, nm, mw, cp, cmp, base, loop"
	default y
	help
	  Memeory commands.
	    md - memory display
	    mm - memory modify (auto-incrementing address)
	    nm - memory modify (constant address)
	    mw - memory write (fill)
	    cp - memory copy
	    cmp - memory compare
	    base - print or set address offset
	    loop - initinite loop on address range

config CMD_CRC32
	bool "crc32"
	default y
	help
	  Compute CRC32.

config LOOPW
	bool "loopw"
	help
	  Infinite write loop on address range

config CMD_MEMTEST
	bool "crc32"
	help
	  Simple RAM read/write test.

config CMD_MX_CYCLIC
	bool "mdc, mwc"
	help
	  mdc - memory display cyclic
	  mwc - memory write cyclic

config CMD_MEMINFO
	bool "meminfo"
	help
	  Display memory information.

endmenu

menu "Device access commands"

config CMD_LOADB
	bool "loadb"
	default y
	help
	  Load a binary file over serial line.

config CMD_LOADS
	bool "loads"
	default y
	help
	  Load an S-Record file over serial line

config CMD_FLASH
	bool "flinfo, erase, protect"
	default y if !SYS_NO_FLASH
	help
	  NOR flash support.
	    flinfo - print FLASH memory information
	    erase - FLASH memory
	    protect - enable or disable FLASH write protection

config MTD_DEVICE
	bool "MTD device support"

config CMD_MTDPARTS
	bool "MTD partitioning support"
	default y
	depends on MTD_DEVICE && (CMD_FLASH || CMD_NAND)

config CMD_NAND
	bool "nand"
	help
	  NAND support.

config CMD_NAND_TRIMFFS
	bool "Enable nand write.trimffs command"
	help
	  Enable command to leave page sized runs of 0xff patterns in
	  erased state rather than overwriting them. This is required
	  for using NAND flash filesystems on NAND controllers with
	  a non-0xff ECC code for all 0xff data.

config CMD_ROMUPDATE
	bool
	depends on NAND

config CMD_MMC
	bool "mmc/sd"
	select PARTITIONS
	help
	  MMC/SD support.

config CMD_SPI
	bool "sspi"
	help
	  SPI utility command.

config CMD_I2C
	bool "i2c"
	help
	  I2C support.

config CMD_USB
	bool "usb"
	help
	  USB support.

config CMD_FPGA
	bool "fpga"
	default y
	help
	  FPGA support.

endmenu


menu "Shell scripting commands"

config CMD_ECHO
	bool "echo"
	default y
	help
	  Echo args to console

config CMD_ITEST
	bool "itest"
	default y
	help
	  Return true/false on integer compare.

config CMD_SOURCE
	bool "source"
	default y
	help
	  Run script from memory

endmenu

menu "Network commands"

config CMD_NET
	bool "bootp, tftpboot"
	default y
	help
	  Network commands.
	  bootp - boot image via network using BOOTP/TFTP protocol
	  tftpboot - boot image via network using TFTP protocol

config CMD_TFTPPUT
	bool "tftp put"
	help
	  TFTP put command, for uploading files to a server

config CMD_TFTPSRV
	bool "tftpsrv"
	help
	  Act as a TFTP server and boot the first received file

config CMD_RARP
	bool "rarpboot"
	help
	  Boot image via network using RARP/TFTP protocol

config CMD_DHCP
	bool "dhcp"
	help
	  Boot image via network using DHCP/TFTP protocol

if CMD_DHCP

menu "DHCP options"

config BOOTP_BOOTFILESIZE
	bool "obtain bootfile size from DHCP"

config BOOTP_BOOTPATH
	bool "obtain bootfile path from DHCP"

config BOOTP_DNS
	bool "obtain DNS server IP address from DHCP"

config BOOTP_DNS2
	bool "store secondary DNS IP address in dnsip2"

config BOOTP_GATEWAY
	bool "obtain gateway IP address from DHCP"

config BOOTP_ID_CACHE_SIZE
	int "DHCP transaction ID cache size"
	default 4
	help
	  BOOTP packets are uniquely identified using a 32-bit ID. The
	  server will copy the ID from client requests to responses and
	  U-Boot will use this to determine if it is the destination of
	  an incoming response. Some servers will check that addresses
	  aren't in use before handing them out (usually using an ARP
	  ping) and therefore take up to a few hundred milliseconds to
	  respond. Network congestion may also influence the time it
	  takes for a response to make it back to the client. If that
	  time is too long, U-Boot will retransmit requests. In order
	  to allow earlier responses to still be accepted after these
	  retransmissions, U-Boot's BOOTP client keeps a small cache of
	  IDs. The CONFIG_BOOTP_ID_CACHE_SIZE controls the size of this
	  cache. The default is to keep IDs for up to four outstanding
	  requests. Increasing this will allow U-Boot to accept offers
	  from a BOOTP client in networks with unusually high latency.

config BOOTP_MAY_FAIL
	bool "Do not start over, if DHCP server is not available"
	help
	  If the DHCP server is not found after the configured retry
	  count, the call will fail instead of starting over.  This
	  can be used to fail over to Link-local IP address
	  configuration if the DHCP server is not available.

config BOOTP_NISDOMAIN
	bool "obtain NIS domain from DHCP"

config BOOTP_NTPSERVER
	bool "obtain NTP server IP address from DHCP"

config BOOTP_RANDOM_DELAY
	bool "Use a (pseudo) random delay between DHCP retries"
	select LIB_RAND

config BOOTP_RANDOM_ID
	bool "Generate a (pseudo) random transaction ID"
	select LIB_RAND

config BOOTP_SEND_HOSTNAME
	bool "send hostname in DHCP request"

config BOOTP_SUBNETMASK
	bool "obtain subnet mask from DHCP"

config BOOTP_TIMEOFFSET
	bool "obtain  from DHCP"

config BOOTP_VENDOREX
	bool "obtain  from DHCP"

endmenu

endif

config CMD_NFS
	bool "nfs"
	default y
	help
	  Boot image via network using NFS protocol.

config CMD_PING
	bool "ping"
	help
	  Send ICMP ECHO_REQUEST to network host

config CMD_CDP
	bool "cdp"
	help
	  Perform CDP network configuration

config CMD_SNTP
	bool "sntp"
	help
	  Synchronize RTC via network

config CMD_DNS
	bool "dns"
	help
	  Lookup the IP of a hostname

config CMD_LINK_LOCAL
	bool "linklocal"
	help
	  Acquire a network IP address using the link-local protocol

config CMD_MII
	bool "MII register access"
	help
	  Support reading/writing ETH PHY registers via MII bus

endmenu

menu "Misc commands"

config CMD_CACHE
	bool "cache control"
	help
	  Enable commands to switch data cache on/off.

config CMD_TIME
	bool "time"
	help
	  Run commands and summarize execution time.

config CMD_FUSE
	bool "fuse read/write"
	help
	  eFuse reading and programming support

# TODO: rename to CMD_SLEEP
config CMD_MISC
	bool "sleep"
	default y
	help
	  Delay execution for some time

config CMD_TIMER
	bool "timer"
	help
	  Access the system timer.

config CMD_SETGETDCR
	bool "getdcr, setdcr, getidcr, setidcr"
	depends on 4xx
	default y
	help
	  getdcr - Get an AMCC PPC 4xx DCR's value
	  setdcr - Set an AMCC PPC 4xx DCR's value
	  getidcr - Get a register value via indirect DCR addressing
	  setidcr - Set a register value via indirect DCR addressing

endmenu

endmenu

menu "Environment configuration settings"

choice
	prompt "Select environment non-volatile storage"

config ENV_IS_NOWHERE
	bool "do not store environment"

config ENV_IS_IN_NAND
	bool "store environment in NAND"
	depends on NAND

config ENV_IS_IN_MMC
	bool "store environment in MMC"
	depends on MMC

config ENV_IS_IN_SPI_FLASH
	bool "store environment in SPI flash"

endchoice

endmenu

menu "Display configuration"

config LCD
	bool "LCD support"

config DISPLAY_BOARDINFO
	bool "Display board info"

endmenu
```
